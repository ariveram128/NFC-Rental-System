## CMakeLists.txt
```
# SPDX-License-Identifier: Apache-2.0

cmake_minimum_required(VERSION 3.20.0)

# Find external Zephyr project
find_package(Zephyr REQUIRED HINTS $ENV{ZEPHYR_BASE})

# Add main project target
project(rentscan_test_loopback)

# Include directories from both main_device and gateway_device
include_directories(
  ${CMAKE_CURRENT_SOURCE_DIR}/include
  ${CMAKE_CURRENT_SOURCE_DIR}/../common/include
  ${CMAKE_CURRENT_SOURCE_DIR}/../main_device/include
  ${CMAKE_CURRENT_SOURCE_DIR}/../gateway_device/include
  ${CMAKE_CURRENT_SOURCE_DIR}/../main_application/include
)

# Only include the loopback app sources when not building ZTEST tests
if (NOT CONFIG_ZTEST)
  target_sources(app PRIVATE
    src/test_loopback.c
  )
endif()

# Mock implementations always compile
target_sources(app PRIVATE
  src/mock_ble_service.c
  src/mock_ble_central.c
)
```

## prj.conf
```kconfig
# General system configuration
CONFIG_HEAP_MEM_POOL_SIZE=8192
CONFIG_ASSERT=y
CONFIG_REBOOT=y

# Logging
CONFIG_LOG=y
CONFIG_LOG_DEFAULT_LEVEL=3
CONFIG_LOG_MODE_DEFERRED=y
CONFIG_LOG_BUFFER_SIZE=4096

# Enable Bluetooth with both roles
CONFIG_BT=y
CONFIG_BT_PERIPHERAL=y
CONFIG_BT_CENTRAL=y
CONFIG_BT_BROADCASTER=y
CONFIG_BT_OBSERVER=y
CONFIG_BT_DEVICE_NAME="RentScan_Test"
CONFIG_BT_DEVICE_APPEARANCE=833

# Critical BLE controller settings
CONFIG_BT_HCI=y
CONFIG_BT_CTLR=y

# Increase controller resources
# CONFIG_BT_BUF_EVT_DISCARDABLE_COUNT=32
# CONFIG_BT_BUF_EVT_DISCARDABLE_SIZE=255
# CONFIG_BT_BUF_CMD_TX_COUNT=20
# CONFIG_BT_CTLR_RX_BUFFERS=16
# CONFIG_BT_CTLR_TX_BUFFERS=16
# CONFIG_BT_CTLR_TX_BUFFER_SIZE=251
# CONFIG_BT_CTLR_DUP_FILTER_LEN=0
# CONFIG_BT_CTLR_LE_ENC=y
# CONFIG_BT_CTLR_PHY=y
# CONFIG_BT_CTLR_PHY_2M=y
# CONFIG_BT_CTLR_ADVANCED_FEATURES=y
# CONFIG_BT_CTLR_SCAN_REQ_NOTIFY=y
# CONFIG_BT_CTLR_ADV_EXT=y

# Enable separate advertising and scanning instances
CONFIG_BT_MAX_CONN=4
CONFIG_BT_MAX_PAIRED=4 
CONFIG_BT_SMP=y
CONFIG_BT_GATT_CLIENT=y
CONFIG_BT_SCAN=y
CONFIG_BT_CONN_TX_MAX=10
CONFIG_BT_L2CAP_TX_BUF_COUNT=10
CONFIG_BT_BUF_ACL_TX_COUNT=10
CONFIG_BT_BUF_ACL_RX_COUNT=10

# Enhanced Bluetooth configuration
CONFIG_BT_GATT_DYNAMIC_DB=y
CONFIG_BT_SETTINGS=y
CONFIG_BT_L2CAP_TX_MTU=247
CONFIG_BT_BUF_ACL_TX_SIZE=251
CONFIG_BT_BUF_ACL_RX_SIZE=251

# Advanced controller settings to avoid resource contention
# CONFIG_BT_CTLR_DATA_LENGTH_MAX=251
# CONFIG_BT_CTLR_ADV_DATA_LEN_MAX=31
# CONFIG_BT_CTLR_ADV_DATA_BUF_MAX=4
# CONFIG_BT_CTLR_SCAN_DATA_LEN_MAX=31
# CONFIG_BT_CTLR_ADV_SET=2
CONFIG_BT_EXT_ADV=y
CONFIG_BT_EXT_ADV_MAX_ADV_SET=2

# Storage for settings
CONFIG_FLASH=y
CONFIG_FLASH_MAP=y
CONFIG_NVS=y
CONFIG_SETTINGS=y
CONFIG_SETTINGS_NVS=y
CONFIG_MPU_ALLOW_FLASH_WRITE=y

# Threading and scheduling
CONFIG_SYSTEM_WORKQUEUE_STACK_SIZE=4096
CONFIG_MAIN_STACK_SIZE=4096
CONFIG_INIT_STACKS=y

# Enable shell for interactive testing
CONFIG_SHELL=y
CONFIG_SHELL_PROMPT_UART="rentscan_test:~$ "
CONFIG_SHELL_CMDS=y
CONFIG_SHELL_STATS=y
CONFIG_SHELL_HISTORY=y
CONFIG_SHELL_VT100_COLORS=y

# Enable Zephyr ZTEST framework
CONFIG_ZTEST=y
```

## src/mock_ble_central.c
```c
/**
 * @file mock_ble_central.c
 * @brief Mock implementation of BLE central functionality
 */

#include <zephyr/kernel.h>
#include <zephyr/bluetooth/bluetooth.h>
#include <zephyr/bluetooth/uuid.h>
#include <zephyr/bluetooth/gatt.h>
#include <zephyr/bluetooth/hci.h>
#include <zephyr/logging/log.h>

#include "../../common/include/rentscan_protocol.h"

LOG_MODULE_REGISTER(mock_ble_central, LOG_LEVEL_INF);

/* Callback function pointer */
static void (*data_callback)(const uint8_t *data, uint16_t len);

/* Connection state */
static struct bt_conn *current_conn;
static bool discovery_complete;

/* UUIDs */
static struct bt_uuid_128 rentscan_service_uuid = BT_UUID_INIT_128(BT_UUID_RENTSCAN_VAL);
static struct bt_uuid_128 rentscan_rx_uuid = BT_UUID_INIT_128(BT_UUID_RENTSCAN_RX_VAL);
static struct bt_uuid_128 rentscan_tx_uuid = BT_UUID_INIT_128(BT_UUID_RENTSCAN_TX_VAL);

/* GATT subscription */
static struct bt_gatt_subscribe_params tx_subscribe_params;

/* Handle storage */
static uint16_t rx_handle;
static uint16_t tx_handle;

/* Device found during scanning */
static bt_addr_le_t found_device;
static bool is_device_found = false;

/* Work for connecting to device */
static struct k_work_delayable connect_work;

/* Scan parameters */
static const struct bt_le_scan_param scan_param = {
    .type = BT_LE_SCAN_TYPE_ACTIVE,
    .options = BT_LE_SCAN_OPT_FILTER_DUPLICATE,
    .interval = BT_GAP_SCAN_FAST_INTERVAL,
    .window = BT_GAP_SCAN_FAST_WINDOW,
};

/* GATT service discovery */
static struct bt_gatt_discover_params discover_params;

/* Helper function to find UUID in advertisement data */
static bool find_uuid_in_advertising_data(const uint8_t *data, uint16_t data_len, 
                                         const uint8_t *uuid, uint8_t uuid_len)
{
    uint8_t ad_type;
    uint8_t ad_len;
    uint8_t *ad_data;
    uint8_t pos = 0;
    
    while (pos < data_len) {
        ad_len = data[pos++];
        if (ad_len == 0) {
            break;
        }
        
        if (pos + ad_len > data_len) {
            break;
        }
        
        ad_type = data[pos++];
        ad_data = (uint8_t *)&data[pos];
        
        /* Looking for UUID128 fields */
        if ((ad_type == BT_DATA_UUID128_ALL || ad_type == BT_DATA_UUID128_SOME) && 
            ad_len >= uuid_len + 1) {
            if (memcmp(ad_data, uuid, uuid_len) == 0) {
                return true;
            }
        }
        
        pos += (ad_len - 1);
    }
    
    return false;
}

/* Data received callback */
static uint8_t notify_func(struct bt_conn *conn,
                         struct bt_gatt_subscribe_params *params,
                         const void *data, uint16_t length)
{
    if (!data) {
        LOG_INF("Unsubscribed");
        params->value_handle = 0U;
        return BT_GATT_ITER_STOP;
    }

    LOG_INF("Central received notify, %u bytes", length);
    
    if (data_callback) {
        data_callback(data, length);
    }
    
    return BT_GATT_ITER_CONTINUE;
}

/* Find service and characteristic handlers */
static uint8_t discover_func(struct bt_conn *conn,
                            const struct bt_gatt_attr *attr,
                            struct bt_gatt_discover_params *params)
{
    int err;

    if (!attr) {
        LOG_INF("Discover complete");
        (void)memset(params, 0, sizeof(*params));
        return BT_GATT_ITER_STOP;
    }

    LOG_INF("[ATTRIBUTE] handle %u", attr->handle);

    if (bt_uuid_cmp(discover_params.uuid, &rentscan_service_uuid.uuid) == 0) {
        /* RentScan service found, now discover characteristics */
        discover_params.uuid = &rentscan_rx_uuid.uuid;
        discover_params.start_handle = attr->handle + 1;
        discover_params.type = BT_GATT_DISCOVER_CHARACTERISTIC;

        err = bt_gatt_discover(conn, &discover_params);
        if (err) {
            LOG_ERR("Discover RX failed (err %d)", err);
        }
    } else if (bt_uuid_cmp(discover_params.uuid, &rentscan_rx_uuid.uuid) == 0) {
        /* RX characteristic found */
        rx_handle = bt_gatt_attr_value_handle(attr);
        LOG_INF("Found RX characteristic, handle %u", rx_handle);
        
        /* Now discover TX characteristic */
        discover_params.uuid = &rentscan_tx_uuid.uuid;
        discover_params.start_handle = attr->handle + 1;
        discover_params.type = BT_GATT_DISCOVER_CHARACTERISTIC;

        err = bt_gatt_discover(conn, &discover_params);
        if (err) {
            LOG_ERR("Discover TX failed (err %d)", err);
        }
    } else if (bt_uuid_cmp(discover_params.uuid, &rentscan_tx_uuid.uuid) == 0) {
        /* TX characteristic found */
        tx_handle = bt_gatt_attr_value_handle(attr);
        LOG_INF("Found TX characteristic, handle %u", tx_handle);
        
        /* Subscribe to TX notifications */
        tx_subscribe_params.notify = notify_func;
        tx_subscribe_params.value = BT_GATT_CCC_NOTIFY;
        tx_subscribe_params.value_handle = tx_handle;
        tx_subscribe_params.ccc_handle = bt_gatt_attr_value_handle(attr) + 1;

        err = bt_gatt_subscribe(conn, &tx_subscribe_params);
        if (err && err != -EALREADY) {
            LOG_ERR("Subscribe failed (err %d)", err);
        } else {
            LOG_INF("Subscribed to notifications");
            discovery_complete = true;
        }

        return BT_GATT_ITER_STOP;
    }

    return BT_GATT_ITER_STOP;
}

/* Device found during scanning */
static void device_found_cb(const bt_addr_le_t *addr, int8_t rssi, uint8_t type,
                        struct net_buf_simple *ad)
{
    char addr_str[BT_ADDR_LE_STR_LEN];
    bt_addr_le_to_str(addr, addr_str, sizeof(addr_str));

    /* We're only interested in connectable devices */
    if (type != BT_GAP_ADV_TYPE_ADV_IND && 
        type != BT_GAP_ADV_TYPE_ADV_DIRECT_IND) {
        return;
    }

    /* Check if the device has the RentScan service UUID */
    if (find_uuid_in_advertising_data(ad->data, ad->len, 
                                     rentscan_service_uuid.val, 16)) {
        LOG_INF("Found RentScan device %s (RSSI %d)", addr_str, rssi);
        
        /* Stop scanning */
        bt_le_scan_stop();
        
        /* Save device address for connection */
        bt_addr_le_copy(&found_device, addr);
        is_device_found = true;
        
        /* Schedule connection attempt */
        k_work_schedule(&connect_work, K_MSEC(100));
    }
}

/* Connect work handler */
static void connect_work_handler(struct k_work *work)
{
    int err;
    
    if (!is_device_found) {
        return;
    }
    
    LOG_INF("Connecting to device...");
    
    /* Connect to device */
    err = bt_conn_le_create(&found_device, BT_CONN_LE_CREATE_CONN, 
                          BT_LE_CONN_PARAM_DEFAULT, &current_conn);
    if (err) {
        LOG_ERR("Create connection failed (err %d)", err);
        
        /* Restart scanning */
        is_device_found = false;
        mock_ble_central_start_scan();
    }
}

/* Connection callbacks */
static void connected(struct bt_conn *conn, uint8_t err)
{
    if (err) {
        LOG_ERR("Connection failed (err %u)", err);
        
        /* Restart scanning */
        is_device_found = false;
        mock_ble_central_start_scan();
        return;
    }

    /* Check if this is the device we were looking for */
    if (is_device_found) {
        LOG_INF("Central connected");
        current_conn = bt_conn_ref(conn);
        
        /* Start service discovery */
        discovery_complete = false;
        discover_params.uuid = &rentscan_service_uuid.uuid;
        discover_params.func = discover_func;
        discover_params.start_handle = BT_ATT_FIRST_ATTRIBUTE_HANDLE;
        discover_params.end_handle = BT_ATT_LAST_ATTRIBUTE_HANDLE;
        discover_params.type = BT_GATT_DISCOVER_PRIMARY;

        err = bt_gatt_discover(conn, &discover_params);
        if (err) {
            LOG_ERR("Discover failed (err %d)", err);
            bt_conn_disconnect(conn, BT_HCI_ERR_REMOTE_USER_TERM_CONN);
        }
    }
}

static void disconnected(struct bt_conn *conn, uint8_t reason)
{
    LOG_INF("Central disconnected (reason %u)", reason);

    if (current_conn) {
        bt_conn_unref(current_conn);
        current_conn = NULL;
    }

    /* Restart scanning */
    is_device_found = false;
    discovery_complete = false;
    mock_ble_central_start_scan();
}

BT_CONN_CB_DEFINE(conn_callbacks) = {
    .connected = connected,
    .disconnected = disconnected,
};

/* Mock API functions */

int mock_ble_central_init(void (*cb)(const uint8_t *, uint16_t))
{
    data_callback = cb;
    k_work_init_delayable(&connect_work, connect_work_handler);
    LOG_INF("Mock BLE central initialized");
    return 0;
}

int mock_ble_central_start_scan(void)
{
    int err;

    err = bt_le_scan_start(&scan_param, device_found_cb);
    if (err) {
        LOG_ERR("Scanning failed to start (err %d)", err);
        return err;
    }

    LOG_INF("Central scanning started");
    return 0;
}

int mock_ble_central_connect_to_device(void)
{
    if (!is_device_found) {
        return -ENODEV;
    }

    k_work_schedule(&connect_work, K_NO_WAIT);
    return 0;
}

int mock_ble_central_send_data(const uint8_t *data, uint16_t len)
{
    int err;

    if (!current_conn || !discovery_complete) {
        return -ENOTCONN;
    }

    LOG_INF("Central sending write, %d bytes", len);
    
    err = bt_gatt_write_without_response(current_conn, rx_handle, data, len, false);
    if (err) {
        LOG_ERR("Write failed (err %d)", err);
    }
    
    return err;
}

bool mock_ble_central_is_connected(void)
{
    return current_conn != NULL && discovery_complete;
}
```

## src/mock_ble_service.c
```c
/**
 * @file mock_ble_service.c
 * @brief Mock implementation of BLE peripheral service
 */

#include <zephyr/kernel.h>
#include <zephyr/bluetooth/bluetooth.h>
#include <zephyr/bluetooth/uuid.h>
#include <zephyr/bluetooth/gatt.h>
#include <zephyr/logging/log.h>

#include "../../common/include/rentscan_protocol.h"

LOG_MODULE_REGISTER(mock_ble_service, LOG_LEVEL_INF);

/* Callback function pointer */
static void (*data_callback)(const uint8_t *data, uint16_t len);

/* Connection state */
static struct bt_conn *current_conn;
static bool is_advertising = false;

/* Define the RentScan service and characteristic UUIDs */
static struct bt_uuid_128 rentscan_service_uuid = BT_UUID_INIT_128(BT_UUID_RENTSCAN_VAL);
static struct bt_uuid_128 rentscan_rx_uuid = BT_UUID_INIT_128(BT_UUID_RENTSCAN_RX_VAL);
static struct bt_uuid_128 rentscan_tx_uuid = BT_UUID_INIT_128(BT_UUID_RENTSCAN_TX_VAL);

/* Advertising data */
static const struct bt_data ad[] = {
    BT_DATA_BYTES(BT_DATA_FLAGS, (BT_LE_AD_GENERAL | BT_LE_AD_NO_BREDR)),
    BT_DATA(BT_DATA_NAME_COMPLETE, RENTSCAN_DEVICE_NAME, sizeof(RENTSCAN_DEVICE_NAME) - 1),
    BT_DATA_BYTES(BT_DATA_UUID128_ALL, BT_UUID_RENTSCAN_VAL),
};

/* Function declarations */
static ssize_t on_receive(struct bt_conn *conn,
                         const struct bt_gatt_attr *attr,
                         const void *buf,
                         uint16_t len,
                         uint16_t offset,
                         uint8_t flags);

static void tx_ccc_changed(const struct bt_gatt_attr *attr, uint16_t value);

/* Service Declaration */
BT_GATT_SERVICE_DEFINE(rentscan_svc,
    BT_GATT_PRIMARY_SERVICE(&rentscan_service_uuid),
    BT_GATT_CHARACTERISTIC(&rentscan_rx_uuid.uuid,
                        BT_GATT_CHRC_WRITE | BT_GATT_CHRC_WRITE_WITHOUT_RESP,
                        BT_GATT_PERM_WRITE,
                        NULL, on_receive, NULL),
    BT_GATT_CHARACTERISTIC(&rentscan_tx_uuid.uuid,
                        BT_GATT_CHRC_NOTIFY,
                        BT_GATT_PERM_NONE,
                        NULL, NULL, NULL),
    BT_GATT_CCC(tx_ccc_changed, BT_GATT_PERM_READ | BT_GATT_PERM_WRITE),
);

/* Connection callbacks */
static void connected(struct bt_conn *conn, uint8_t err)
{
    if (err) {
        LOG_ERR("Connection failed (err %u)", err);
        return;
    }

    current_conn = bt_conn_ref(conn);
    LOG_INF("Peripheral connected");
}

static void disconnected(struct bt_conn *conn, uint8_t reason)
{
    LOG_INF("Peripheral disconnected (reason %u)", reason);

    if (current_conn) {
        bt_conn_unref(current_conn);
        current_conn = NULL;
    }
}

BT_CONN_CB_DEFINE(conn_callbacks) = {
    .connected = connected,
    .disconnected = disconnected,
};

/* Client characteristic configuration changed */
static void tx_ccc_changed(const struct bt_gatt_attr *attr, uint16_t value)
{
    bool notifications_enabled = (value == BT_GATT_CCC_NOTIFY);
    LOG_INF("Notifications %s", notifications_enabled ? "enabled" : "disabled");
}

/* Data received handler */
static ssize_t on_receive(struct bt_conn *conn,
                         const struct bt_gatt_attr *attr,
                         const void *buf,
                         uint16_t len,
                         uint16_t offset,
                         uint8_t flags)
{
    LOG_INF("Peripheral received data, len %u", len);
    
    if (data_callback) {
        data_callback(buf, len);
    }
    
    return len;
}

/* Mock API functions */

int mock_ble_service_init(void (*cb)(const uint8_t *, uint16_t))
{
    data_callback = cb;
    LOG_INF("Mock BLE service initialized");
    return 0;
}

int mock_ble_service_start_advertising(bool fast)
{
    if (is_advertising) {
        return 0;
    }

    int err;
    
    if (fast) {
        err = bt_le_adv_start(BT_LE_ADV_CONN, ad, ARRAY_SIZE(ad), NULL, 0);
    } else {
        /* Use slower advertising parameters for power saving */
        static const struct bt_le_adv_param slow_adv_param = {
            .id = BT_ID_DEFAULT,
            .sid = 0,
            .secondary_max_skip = 0,
            .options = BT_LE_ADV_OPT_CONNECTABLE | BT_LE_ADV_OPT_USE_NAME,
            .interval_min = BT_GAP_ADV_SLOW_INT_MIN,
            .interval_max = BT_GAP_ADV_SLOW_INT_MAX,
            .peer = NULL,
        };
        err = bt_le_adv_start(&slow_adv_param, ad, ARRAY_SIZE(ad), NULL, 0);
    }

    if (!err) {
        is_advertising = true;
        LOG_INF("Peripheral advertising started (%s mode)", fast ? "fast" : "slow");
    } else {
        LOG_ERR("Peripheral advertising failed to start (err %d)", err);
    }
    return err;
}

int mock_ble_service_send_data(const uint8_t *data, uint16_t len)
{
    if (!current_conn) {
        return -ENOTCONN;
    }

    struct bt_gatt_notify_params params = {0};
    params.uuid = NULL;
    params.attr = &rentscan_svc.attrs[3];  // TX characteristic
    params.data = data;
    params.len = len;
    params.func = NULL;

    LOG_INF("Peripheral sending data, %d bytes", len);
    return bt_gatt_notify_cb(current_conn, &params);
}

bool mock_ble_service_is_connected(void)
{
    return current_conn != NULL;
}
```

## src/test_loopback.c
```c
/**
 * @file test_loopback.c
 * @brief RentScan loopback test application
 */

#include <zephyr/kernel.h>
#include <zephyr/bluetooth/bluetooth.h>
#include <zephyr/bluetooth/uuid.h>
#include <zephyr/bluetooth/gatt.h>
#include <zephyr/logging/log.h>
#include <zephyr/shell/shell.h>

#include "../../common/include/rentscan_protocol.h"

LOG_MODULE_REGISTER(test_loopback, LOG_LEVEL_INF);

/* Function declarations for mock implementations */
int mock_ble_service_init(void (*cb)(const uint8_t *, uint16_t));
int mock_ble_service_start_advertising(bool fast);
int mock_ble_service_send_data(const uint8_t *data, uint16_t len);
bool mock_ble_service_is_connected(void);

int mock_ble_central_init(void (*cb)(const uint8_t *, uint16_t));
int mock_ble_central_start_scan(void);
int mock_ble_central_send_data(const uint8_t *data, uint16_t len);
bool mock_ble_central_is_connected(void);

/* Max retry attempts */
#define MAX_RETRY_ATTEMPTS 5
#define RETRY_DELAY_MS 1000
#define BLE_ROLE_SWITCH_DELAY_MS 2000

/* Test statistics */
static struct {
    uint32_t peripheral_msgs_sent;
    uint32_t peripheral_msgs_received;
    uint32_t central_msgs_sent;
    uint32_t central_msgs_received;
    uint32_t test_sequence;
} test_stats;

/* Test message work */
static struct k_work_delayable test_msg_work;
static struct k_work_delayable start_scan_work;
static struct k_work_delayable retry_work;

/* Retry state */
static struct {
    int remaining_adv_attempts;
    int remaining_scan_attempts;
    bool adv_started;
    bool scan_started;
} retry_state;

/* Message handlers */
static void peripheral_data_received(const uint8_t *data, uint16_t len)
{
    LOG_INF("Peripheral received data (%u bytes)", len);
    test_stats.peripheral_msgs_received++;
    
    /* Log the message type if it's a RentScan protocol message */
    if (len >= 1) {
        LOG_INF("  Message type: %u", data[0]);
    }
}

static void central_data_received(const uint8_t *data, uint16_t len)
{
    LOG_INF("Central received data (%u bytes)", len);
    test_stats.central_msgs_received++;
    
    /* Log the message type if it's a RentScan protocol message */
    if (len >= 1) {
        LOG_INF("  Message type: %u", data[0]);
    }
}

/* Send a test message */
static void send_test_message(void)
{
    uint8_t test_data[8];
    
    test_stats.test_sequence++;
    
    /* Alternate between peripheral and central sending messages */
    if (test_stats.test_sequence % 2 == 0) {
        /* Peripheral sending to central */
        if (mock_ble_service_is_connected()) {
            /* Create a test status message */
            test_data[0] = CMD_STATUS_RESP;  /* Status response message */
            test_data[1] = STATUS_AVAILABLE; /* Status available */
            test_data[2] = test_stats.test_sequence; /* Test sequence number */
            
            if (mock_ble_service_send_data(test_data, 3) == 0) {
                test_stats.peripheral_msgs_sent++;
                LOG_INF("Peripheral sent test message %u", test_stats.test_sequence);
            }
        }
    } else {
        /* Central sending to peripheral */
        if (mock_ble_central_is_connected()) {
            /* Create a test status request message */
            test_data[0] = CMD_STATUS_REQ;  /* Status request message */
            test_data[1] = test_stats.test_sequence; /* Test sequence number */
            
            if (mock_ble_central_send_data(test_data, 2) == 0) {
                test_stats.central_msgs_sent++;
                LOG_INF("Central sent test message %u", test_stats.test_sequence);
            }
        }
    }
    
    /* Schedule next message */
    k_work_schedule(&test_msg_work, K_SECONDS(10));
}

/* Test message work handler */
static void test_msg_work_handler(struct k_work *work)
{
    send_test_message();
}

/* Forward declaration for retry work handler */
static void retry_work_handler(struct k_work *work);

/* Start advertising function */
static int start_advertising(void)
{
    int err = mock_ble_service_start_advertising(true);
    if (err) {
        if (err == -EAGAIN && retry_state.remaining_adv_attempts > 0) {
            LOG_WRN("Advertising failed with EAGAIN, will retry (%d attempts left)", 
                   retry_state.remaining_adv_attempts);
            retry_state.remaining_adv_attempts--;
            k_work_schedule(&retry_work, K_MSEC(RETRY_DELAY_MS));
            return 0;
        } else {
            LOG_ERR("Advertising failed to start (err %d), no retries left", err);
            return err;
        }
    } else {
        LOG_INF("Advertising started successfully");
        retry_state.adv_started = true;
        return 0;
    }
}

/* Start scanning function */
static void start_scan_work_handler(struct k_work *work)
{
    int err = mock_ble_central_start_scan();
    if (err) {
        if (err == -EAGAIN && retry_state.remaining_scan_attempts > 0) {
            LOG_WRN("Scanning failed with EAGAIN, will retry (%d attempts left)", 
                   retry_state.remaining_scan_attempts);
            retry_state.remaining_scan_attempts--;
            /* Schedule retry after a longer delay */
            k_work_schedule(&retry_work, K_MSEC(RETRY_DELAY_MS * 2));
        } else {
            LOG_ERR("Scanning failed to start (err %d), no retries left", err);
        }
    } else {
        LOG_INF("Scanning started successfully");
        retry_state.scan_started = true;
    }
}

/* Retry work handler */
static void retry_work_handler(struct k_work *work)
{
    /* First try advertising if not started */
    if (!retry_state.adv_started && retry_state.remaining_adv_attempts > 0) {
        start_advertising();
    } 
    /* Then try scanning if advertising started and scanning not started */
    else if (retry_state.adv_started && !retry_state.scan_started && 
             retry_state.remaining_scan_attempts > 0) {
        start_scan_work_handler(NULL);
    }
}

/* Reset BLE stack */
static int reset_ble_stack(void)
{
    int err;
    
    LOG_INF("Disabling Bluetooth...");
    err = bt_disable();
    if (err) {
        LOG_ERR("Failed to disable Bluetooth (err %d)", err);
        return err;
    }
    
    LOG_INF("Bluetooth disabled, waiting before re-enabling...");
    k_sleep(K_MSEC(3000));
    
    /* Re-enable Bluetooth */
    LOG_INF("Re-enabling Bluetooth...");
    err = bt_enable(NULL);
    if (err) {
        LOG_ERR("Failed to re-enable Bluetooth (err %d)", err);
        return err;
    }
    
    LOG_INF("Bluetooth re-enabled, waiting to stabilize...");
    k_sleep(K_MSEC(2000));
    
    return 0;
}

/* Initialize peripherals */
static int init_peripherals(void)
{
    int err;
    
    /* Initialize peripheral role */
    err = mock_ble_service_init(peripheral_data_received);
    if (err) {
        LOG_ERR("Peripheral init failed (err %d)", err);
        return err;
    }
    
    /* Initialize central role */
    err = mock_ble_central_init(central_data_received);
    if (err) {
        LOG_ERR("Central init failed (err %d)", err);
        return err;
    }
    
    return 0;
}

/* Shell commands */
static int cmd_test_status(const struct shell *sh, size_t argc, char *argv[])
{
    shell_print(sh, "RentScan Loopback Test Status:");
    shell_print(sh, "--------------------------");
    shell_print(sh, "Peripheral connected: %s", 
              mock_ble_service_is_connected() ? "yes" : "no");
    shell_print(sh, "Central connected:    %s", 
              mock_ble_central_is_connected() ? "yes" : "no");
    shell_print(sh, "Messages:");
    shell_print(sh, "  Peripheral sent:    %u", test_stats.peripheral_msgs_sent);
    shell_print(sh, "  Peripheral received: %u", test_stats.peripheral_msgs_received);
    shell_print(sh, "  Central sent:       %u", test_stats.central_msgs_sent);
    shell_print(sh, "  Central received:   %u", test_stats.central_msgs_received);
    shell_print(sh, "  Test sequence:      %u", test_stats.test_sequence);
    return 0;
}

static int cmd_test_send(const struct shell *sh, size_t argc, char *argv[])
{
    send_test_message();
    shell_print(sh, "Test message sent, sequence %u", test_stats.test_sequence);
    return 0;
}

/* Start advertising command */
static int cmd_start_adv(const struct shell *sh, size_t argc, char *argv[])
{
    retry_state.remaining_adv_attempts = MAX_RETRY_ATTEMPTS;
    retry_state.adv_started = false;
    
    int err = start_advertising();
    if (err) {
        shell_error(sh, "Advertising failed to start after multiple retries (err %d)", err);
        return -1;
    }
    
    shell_print(sh, "Advertising start initiated with retries");
    return 0;
}

/* Start scanning command */
static int cmd_start_scan(const struct shell *sh, size_t argc, char *argv[])
{
    retry_state.remaining_scan_attempts = MAX_RETRY_ATTEMPTS;
    retry_state.scan_started = false;
    
    k_work_schedule(&start_scan_work, K_NO_WAIT);
    
    shell_print(sh, "Scanning start initiated with retries");
    return 0;
}

/* Reset BLE stack command */
static int cmd_reset_ble(const struct shell *sh, size_t argc, char *argv[])
{
    int err;
    
    shell_print(sh, "Resetting Bluetooth stack...");
    
    err = reset_ble_stack();
    if (err) {
        shell_error(sh, "Failed to reset Bluetooth stack (err %d)", err);
        return -1;
    }
    
    err = init_peripherals();
    if (err) {
        shell_error(sh, "Failed to initialize peripherals (err %d)", err);
        return -1;
    }
    
    shell_print(sh, "Bluetooth stack reset complete, starting advertising and scanning...");
    
    /* Initialize retry state */
    retry_state.remaining_adv_attempts = MAX_RETRY_ATTEMPTS;
    retry_state.remaining_scan_attempts = MAX_RETRY_ATTEMPTS;
    retry_state.adv_started = false;
    retry_state.scan_started = false;
    
    /* Start advertising first */
    start_advertising();
    
    /* Schedule scanning after a delay */
    k_work_schedule(&start_scan_work, K_MSEC(BLE_ROLE_SWITCH_DELAY_MS));
    
    return 0;
}

/* Create subcmd set for scan subcommand */
SHELL_STATIC_SUBCMD_SET_CREATE(scan_cmds,
    SHELL_CMD(start, NULL, "Start scanning for devices", cmd_start_scan),
    SHELL_SUBCMD_SET_END
);

/* Create subcmd set for adv subcommand */
SHELL_STATIC_SUBCMD_SET_CREATE(adv_cmds,
    SHELL_CMD(start, NULL, "Start advertising", cmd_start_adv),
    SHELL_SUBCMD_SET_END
);

/* Create subcmd set for rentscan_test command */
SHELL_STATIC_SUBCMD_SET_CREATE(rentscan_test_cmds,
    SHELL_CMD(status, NULL, "Show test status", cmd_test_status),
    SHELL_CMD(send, NULL, "Send test message", cmd_test_send),
    SHELL_CMD(scan, &scan_cmds, "Scanning commands", NULL),
    SHELL_CMD(adv, &adv_cmds, "Advertising commands", NULL),
    SHELL_CMD(reset, NULL, "Reset Bluetooth stack and restart", cmd_reset_ble),
    SHELL_SUBCMD_SET_END
);

/* Register rentscan_test command */
SHELL_CMD_REGISTER(rentscan_test, &rentscan_test_cmds, "RentScan test commands", NULL);

/* Main application */
#if !defined(CONFIG_ZTEST)
int main(void)
{
    int err;
    
    LOG_INF("RentScan loopback test starting");
    
    /* Initialize BLE stack */
    LOG_INF("Enabling Bluetooth...");
    err = bt_enable(NULL);
    if (err) {
        LOG_ERR("Bluetooth init failed (err %d)", err);
        return 0;
    }
    
    LOG_INF("Bluetooth initialized");
    
    /* Add a longer delay to ensure the controller is fully ready */
    k_sleep(K_MSEC(3000));
    
    /* Initialize test statistics */
    memset(&test_stats, 0, sizeof(test_stats));
    
    /* Initialize work items */
    k_work_init_delayable(&test_msg_work, test_msg_work_handler);
    k_work_init_delayable(&start_scan_work, start_scan_work_handler);
    k_work_init_delayable(&retry_work, retry_work_handler);
    
    /* Initialize retry state */
    retry_state.remaining_adv_attempts = MAX_RETRY_ATTEMPTS;
    retry_state.remaining_scan_attempts = MAX_RETRY_ATTEMPTS;
    retry_state.adv_started = false;
    retry_state.scan_started = false;
    
    /* Initialize peripheral role first */
    err = mock_ble_service_init(peripheral_data_received);
    if (err) {
        LOG_ERR("Peripheral init failed (err %d)", err);
        return 0;
    }
    
    LOG_INF("Peripheral role initialized, starting advertising...");
    
    /* Start advertising with retry */
    err = start_advertising();
    if (err) {
        LOG_WRN("Initial advertising failed, will not retry");
    }
    
    /* Add a delay between peripheral and central initialization */
    LOG_INF("Waiting before initializing central role...");
    k_sleep(K_MSEC(BLE_ROLE_SWITCH_DELAY_MS));
    
    /* Initialize central role second */
    LOG_INF("Initializing central role...");
    err = mock_ble_central_init(central_data_received);
    if (err) {
        LOG_ERR("Central init failed (err %d)", err);
        return 0;
    }
    
    /* Start scanning with retry (scheduled) */
    LOG_INF("Central role initialized, scheduling scanning start...");
    k_work_schedule(&start_scan_work, K_MSEC(500));
    
    /* Schedule first test message */
    k_work_schedule(&test_msg_work, K_SECONDS(10));
    
    LOG_INF("Test initialized, waiting for devices to connect");
    
    return 0;
}
#endif
```
