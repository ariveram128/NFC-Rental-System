## CMakeLists.txt
```
cmake_minimum_required(VERSION 3.20.0)

find_package(Zephyr REQUIRED HINTS $ENV{ZEPHYR_BASE})
project(rentscan_main_device)

# Include directories
include_directories(include)
include_directories(../common/include)

# Nordic SDK includes
include_directories($ENV{ZEPHYR_BASE}/../nrf/include)
include_directories($ENV{ZEPHYR_BASE}/../nrfxlib/nfc/include)
include_directories($ENV{ZEPHYR_BASE}/include)
include_directories($ENV{ZEPHYR_BASE}/../modules/hal/nordic/nrfx/hal)

# Sources for this application
target_sources(app PRIVATE
  src/main.c
  src/nfc_handler.c
  src/ble_service.c
  src/rental_manager.c
)

# Add Kconfig overlay
zephyr_include_directories(${CMAKE_CURRENT_SOURCE_DIR}/include)

# Configuration
target_compile_definitions(app PRIVATE
  -DCONFIG_RENTSCAN_MAIN_DEVICE=1
)
```

## prj.conf
```kconfig
# General system configuration
CONFIG_HEAP_MEM_POOL_SIZE=8192
CONFIG_ASSERT=y
CONFIG_REBOOT=y
CONFIG_SPEED_OPTIMIZATIONS=y

# Logging
CONFIG_LOG=y
CONFIG_LOG_DEFAULT_LEVEL=3
CONFIG_LOG_MODE_DEFERRED=y
CONFIG_LOG_BUFFER_SIZE=4096

# Enable Bluetooth
CONFIG_BT=y
CONFIG_BT_PERIPHERAL=y
CONFIG_BT_OBSERVER=y
CONFIG_BT_DEVICE_NAME="RentScan"
CONFIG_BT_DEVICE_APPEARANCE=833
CONFIG_BT_MAX_CONN=1
CONFIG_BT_SMP=y
CONFIG_BT_L2CAP_TX_MTU=247
CONFIG_BT_BUF_ACL_TX_SIZE=251
CONFIG_BT_BUF_ACL_RX_SIZE=251
CONFIG_BT_GATT_CLIENT=y
CONFIG_BT_SCAN=y
CONFIG_BT_BROADCASTER=y  # Explicitly enable advertising capability

# Enhanced Bluetooth configuration
CONFIG_BT_GATT_DYNAMIC_DB=y
CONFIG_BT_SETTINGS=y
CONFIG_BT_NUS=y

# Additional BLE settings for advertising
CONFIG_BT_PERIPHERAL_PREF_MIN_INT=6
CONFIG_BT_PERIPHERAL_PREF_MAX_INT=12
CONFIG_BT_PERIPHERAL_PREF_LATENCY=0
CONFIG_BT_PERIPHERAL_PREF_TIMEOUT=400

# NFC configuration
CONFIG_NCS_SAMPLES_DEFAULTS=y
CONFIG_NRFX_NFCT=y
CONFIG_NFC_T2T_NRFXLIB=y
#CONFIG_NFC_T2T_PARSER=y
CONFIG_NFC_NDEF=y
CONFIG_NFC_NDEF_MSG=y
CONFIG_NFC_NDEF_RECORD=y
CONFIG_NFC_NDEF_TEXT_RECORD=y
CONFIG_NFC_NDEF_URI_MSG=y
CONFIG_NFC_NDEF_URI_REC=y
#CONFIG_NFC_T4T_HL_PROCEDURE=y
#CONFIG_NFC_NDEF_PARSER=y
CONFIG_NFC_PLATFORM=y

# Development kit support
CONFIG_DK_LIBRARY=y

# Storage for settings
CONFIG_FLASH=y
CONFIG_FLASH_MAP=y
CONFIG_NVS=y
CONFIG_SETTINGS=y
CONFIG_SETTINGS_NVS=y
CONFIG_MPU_ALLOW_FLASH_WRITE=y

# Threading and scheduling
CONFIG_SYSTEM_WORKQUEUE_STACK_SIZE=4096
CONFIG_MAIN_STACK_SIZE=4096
CONFIG_INIT_STACKS=y

# Enable watchdog
CONFIG_WATCHDOG=y

# Enable kernel options useful for debugging
CONFIG_DEBUG=y
CONFIG_DEBUG_THREAD_INFO=y

# NFC tag emulation support
CONFIG_NFC_T2T_NRFXLIB=y
CONFIG_NFC_NDEF=y
CONFIG_NFC_NDEF_MSG=y
CONFIG_NFC_NDEF_RECORD=y
CONFIG_NFC_NDEF_TEXT_RECORD=y
```

## src/main.c
```c
/**
 * @file main.c
 * @brief Main application for RentScan main device (NFC reader + BLE peripheral)
 */

#include <zephyr/kernel.h>
#include <zephyr/logging/log.h>
#include <zephyr/settings/settings.h>
#include <zephyr/bluetooth/bluetooth.h>  /* Add this for bt_enable/disable functions */
#include <string.h>

#include "../include/main_device_config.h"
#include "nfc_handler.h"
#include "ble_service.h"
#include "rental_manager.h"
#include "../../common/include/rentscan_protocol.h"

LOG_MODULE_REGISTER(main, LOG_LEVEL_INF);

/* Define work queue items for various tasks */
static struct k_work_delayable expiry_check_work;
static struct k_work nfc_process_work;

/* Buffer for NFC tag data */
static uint8_t tag_data_buf[MAX_MSG_PAYLOAD];
static size_t tag_data_len;
static uint8_t tag_id_buf[MAX_TAG_ID_LEN];
static size_t tag_id_len;

/* Indicate if a tag is being processed */
static bool tag_processing = false;

/**
 * @brief Handler for NFC tag detection events
 */
static void tag_detected_handler(const uint8_t *tag_id, size_t id_len,
                               const uint8_t *tag_data, size_t data_len)
{
    if (tag_processing) {
        LOG_WRN("Already processing a tag, ignoring new tag");
        return;
    }
    
    /* Copy the tag data to our buffer */
    if (id_len > MAX_TAG_ID_LEN) {
        id_len = MAX_TAG_ID_LEN;
    }
    memcpy(tag_id_buf, tag_id, id_len);
    tag_id_len = id_len;
    
    if (tag_data && data_len > 0) {
        if (data_len > MAX_MSG_PAYLOAD) {
            data_len = MAX_MSG_PAYLOAD;
        }
        memcpy(tag_data_buf, tag_data, data_len);
        tag_data_len = data_len;
    } else {
        tag_data_len = 0;
    }
    
    /* Process the tag in the work queue */
    tag_processing = true;
    k_work_submit(&nfc_process_work);
}

/**
 * @brief Handler for BLE data reception
 */
static void ble_data_received_handler(const uint8_t *data, uint16_t len)
{
    /* Process the received command */
    int err = rental_manager_process_command(data, len);
    if (err) {
        LOG_ERR("Failed to process command: %d", err);
    }
}

/**
 * @brief Handler for rental status changes
 */
static void rental_status_changed_handler(const rentscan_msg_t *msg)
{
    /* Send the status update via BLE */
    int err = ble_service_send_message(msg);
    if (err) {
        LOG_ERR("Failed to send status update: %d", err);
    }
    
    /* If we're currently processing a tag, we're done now */
    tag_processing = false;
}

/**
 * @brief NFC tag processing work handler
 */
static void nfc_process_work_handler(struct k_work *work)
{
    LOG_INF("Processing NFC tag with ID: %.*s", tag_id_len, tag_id_buf);
    
    // Create a message to send to the gateway
    rentscan_msg_t msg;
    memset(&msg, 0, sizeof(msg));
    
    // Set message fields
    msg.cmd = CMD_STATUS_REQ; // Request status to check if item is rented
    msg.tag_id_len = tag_id_len;
    memcpy(msg.tag_id, tag_id_buf, tag_id_len);
    msg.timestamp = k_uptime_get_32() / 1000; // Convert to seconds
    
    // Only send if we have a BLE connection
    if (ble_service_is_connected()) {
        int err = ble_service_send_message(&msg);
        if (err) {
            LOG_ERR("Failed to send tag data via BLE: %d", err);
        } else {
            LOG_INF("Tag data sent to gateway");
        }
    } else {
        LOG_WRN("BLE not connected, can't send tag data");
    }
    
    // Process the tag locally
    int err = rental_manager_process_tag(tag_id_buf, tag_id_len,
                                       tag_data_buf, tag_data_len);
    if (err) {
        LOG_ERR("Failed to process tag: %d", err);
    }
    
    // Clear the processing flag
    tag_processing = false;
}

/**
 * @brief Rental expiry check work handler
 */
static void expiry_check_work_handler(struct k_work *work)
{
    /* Check for expired rentals */
    int expired = rental_manager_check_expirations();
    if (expired > 0) {
        LOG_INF("Found %d expired rentals", expired);
    }
    
    /* Reschedule the work */
    k_work_schedule_for_queue(&k_sys_work_q, &expiry_check_work,
                            K_SECONDS(RENTAL_EXPIRY_CHECK_PERIOD));
}

int main(void)
{
    int err;
    
    LOG_INF("RentScan main device starting");
    
    /* Initialize work queue items */
    k_work_init(&nfc_process_work, nfc_process_work_handler);
    k_work_init_delayable(&expiry_check_work, expiry_check_work_handler);
    
    /* Initialize the rental manager */
    err = rental_manager_init(rental_status_changed_handler);
    if (err) {
        LOG_ERR("Failed to initialize rental manager: %d", err);
        return err;
    }
    
    /* Initialize the BLE service */
    err = ble_service_init(ble_data_received_handler);
    if (err) {
        LOG_ERR("Failed to initialize BLE service: %d", err);
        return err;
    }

    /* Load settings - required for BLE address */
    if (IS_ENABLED(CONFIG_SETTINGS)) {
        settings_load();
    }

    /* Wait for BLE stack to fully initialize */
    k_sleep(K_MSEC(100));
    
    /* Initialize the NFC handler */
    err = nfc_handler_init(tag_detected_handler);
    if (err) {
        LOG_ERR("Failed to initialize NFC handler: %d", err);
        return err;
    }
    
    /* Start BLE advertising with retry on error */
    for (int retry = 0; retry < 5; retry++) {
        err = ble_service_start_advertising(true);
        if (err == 0) {
            break;  // Success
        }
        
        LOG_WRN("BLE advertising start failed (attempt %d): %d", retry+1, err);
        k_sleep(K_MSEC(500 * (retry + 1)));  // Progressive backoff
        
        // For specific errors, try a Bluetooth system reset
        if (err == -EINVAL && retry == 2) {
            LOG_INF("Attempting Bluetooth subsystem reset");
            bt_disable();
            k_sleep(K_MSEC(1000));
            err = bt_enable(NULL);
            if (err) {
                LOG_ERR("Bluetooth re-init failed: %d", err);
                continue;
            }
            k_sleep(K_MSEC(100));
        }
    }
    
    if (err) {
        LOG_ERR("Failed to start advertising: %d", err);
        /* Continue anyway */
    }
    
    /* Start NFC polling */
    err = nfc_handler_start_polling();
    if (err) {
        LOG_ERR("Failed to start NFC polling: %d", err);
        /* Continue anyway */
    }
    
    /* Schedule rental expiry check */
    k_work_schedule_for_queue(&k_sys_work_q, &expiry_check_work, 
                            K_SECONDS(RENTAL_EXPIRY_CHECK_PERIOD));
    
    LOG_INF("RentScan main device initialized");
    
    /* Application is now running - Zephyr will handle the threads */
    return 0;
}
```

## include/main_device_config.h
```c
/**
 * @file main_device_config.h
 * @brief Configuration parameters for the main device (NFC reader + BLE peripheral)
 */

#ifndef MAIN_DEVICE_CONFIG_H
#define MAIN_DEVICE_CONFIG_H

/** NFC configuration */
#define NFC_POLL_PERIOD_MS 500        /**< NFC polling period in milliseconds */
#define NFC_READ_RETRY_LIMIT 3        /**< Number of NFC read retries */
#define NFC_WRITE_RETRY_LIMIT 3       /**< Number of NFC write retries */

/** BLE configuration - using Zephyr BLE GAP definitions */
#define BLE_ADV_FAST_INT_MIN 0x0020   /**< Fast advertising interval minimum (20 ms) */
#define BLE_ADV_FAST_INT_MAX 0x0040   /**< Fast advertising interval maximum (40 ms) */
#define BLE_ADV_SLOW_INT_MIN 0x0640   /**< Slow advertising interval minimum (1 second) */
#define BLE_ADV_SLOW_INT_MAX 0x0780   /**< Slow advertising interval maximum (1.2 seconds) */

/** Rental configuration */
#define DEFAULT_RENTAL_DURATION 3600  /**< Default rental duration in seconds (1 hour) */
#define RENTAL_EXPIRY_CHECK_PERIOD 60 /**< How often to check for rental expiry (seconds) */

#endif /* MAIN_DEVICE_CONFIG_H */
```

## src/ble_service.c
```c
#include <zephyr/kernel.h>
#include <zephyr/bluetooth/bluetooth.h>
#include <zephyr/bluetooth/uuid.h>
#include <zephyr/bluetooth/gatt.h>
#include <zephyr/logging/log.h>
#include "ble_service.h"
#include "../../common/include/rentscan_protocol.h"

LOG_MODULE_REGISTER(ble_service, LOG_LEVEL_INF);

static ble_data_received_cb_t data_callback;
static struct bt_conn *current_conn;
static bool is_advertising = false;

/* Buffer for outgoing data */
static uint8_t tx_buffer[sizeof(rentscan_msg_t)];
static uint8_t tx_buffer_len;

/* Function declarations */
static void tx_ccc_changed(const struct bt_gatt_attr *attr, uint16_t value);
static ssize_t on_receive(struct bt_conn *conn,
                         const struct bt_gatt_attr *attr,
                         const void *buf,
                         uint16_t len,
                         uint16_t offset,
                         uint8_t flags);
static void send_response(void);

/* Advertising data */
static const struct bt_data ad[] = {
    BT_DATA_BYTES(BT_DATA_FLAGS, (BT_LE_AD_GENERAL | BT_LE_AD_NO_BREDR)),
    BT_DATA(BT_DATA_NAME_COMPLETE, RENTSCAN_DEVICE_NAME, sizeof(RENTSCAN_DEVICE_NAME) - 1),
    BT_DATA_BYTES(BT_DATA_UUID128_ALL, BT_UUID_RENTSCAN_VAL),
};

/* Service Declaration */
BT_GATT_SERVICE_DEFINE(rentscan_svc,
    BT_GATT_PRIMARY_SERVICE(BT_UUID_RENTSCAN),
    BT_GATT_CHARACTERISTIC(BT_UUID_RENTSCAN_RX,
                        BT_GATT_CHRC_WRITE | BT_GATT_CHRC_WRITE_WITHOUT_RESP,
                        BT_GATT_PERM_WRITE,
                        NULL, on_receive, NULL),
    BT_GATT_CHARACTERISTIC(BT_UUID_RENTSCAN_TX,
                        BT_GATT_CHRC_NOTIFY,
                        BT_GATT_PERM_NONE,
                        NULL, NULL, NULL),
    BT_GATT_CCC(tx_ccc_changed, BT_GATT_PERM_READ | BT_GATT_PERM_WRITE),
);

static void connected(struct bt_conn *conn, uint8_t err)
{
    if (err) {
        LOG_ERR("Connection failed (err %u)", err);
        return;
    }

    current_conn = bt_conn_ref(conn);
    LOG_INF("Connected");
}

static void disconnected(struct bt_conn *conn, uint8_t reason)
{
    LOG_INF("Disconnected (reason %u)", reason);

    if (current_conn) {
        bt_conn_unref(current_conn);
        current_conn = NULL;
    }
}

BT_CONN_CB_DEFINE(conn_callbacks) = {
    .connected = connected,
    .disconnected = disconnected,
};

static void tx_ccc_changed(const struct bt_gatt_attr *attr, uint16_t value)
{
    bool notifications_enabled = (value == BT_GATT_CCC_NOTIFY);
    LOG_INF("Notifications %s", notifications_enabled ? "enabled" : "disabled");
}

static void send_response(void)
{
    if (tx_buffer_len > 0) {
        bt_gatt_notify(NULL, &rentscan_svc.attrs[2], tx_buffer, tx_buffer_len);
        tx_buffer_len = 0;
    }
}

static ssize_t on_receive(struct bt_conn *conn,
                         const struct bt_gatt_attr *attr,
                         const void *buf,
                         uint16_t len,
                         uint16_t offset,
                         uint8_t flags)
{
    LOG_INF("Received data, len %u", len);
    
    if (data_callback) {
        data_callback(buf, len);
    }
    
    return len;
}

int ble_service_init(ble_data_received_cb_t data_received_cb)
{
    int err;

    data_callback = data_received_cb;

    err = bt_enable(NULL);
    if (err) {
        LOG_ERR("Bluetooth init failed (err %d)", err);
        return err;
    }
    
    // Small delay to ensure Bluetooth stack is ready
    k_sleep(K_MSEC(100));

    LOG_INF("Bluetooth initialized");
    return 0;
}

int ble_service_start_advertising(bool fast)
{
    if (is_advertising) {
        return 0;
    }

    int err;
    
    if (fast) {
        // Use standard connectable advertising
        err = bt_le_adv_start(BT_LE_ADV_CONN, ad, ARRAY_SIZE(ad), NULL, 0);
    } else {
        // Create custom slow advertising parameters
        static const struct bt_le_adv_param slow_adv_param = {
            .id = BT_ID_DEFAULT,
            .sid = 0,
            .secondary_max_skip = 0,
            .options = BT_LE_ADV_OPT_CONNECTABLE | BT_LE_ADV_OPT_USE_NAME,
            .interval_min = BT_GAP_ADV_SLOW_INT_MIN,
            .interval_max = BT_GAP_ADV_SLOW_INT_MAX,
            .peer = NULL,
        };
        err = bt_le_adv_start(&slow_adv_param, ad, ARRAY_SIZE(ad), NULL, 0);
    }

    if (!err) {
        is_advertising = true;
        LOG_INF("Advertising started (%s mode)", fast ? "fast" : "slow");
    } else {
        LOG_ERR("Advertising failed to start (err %d)", err);
    }
    return err;
}

int ble_service_stop_advertising(void)
{
    if (!is_advertising) {
        return 0;
    }

    int err = bt_le_adv_stop();
    if (!err) {
        is_advertising = false;
        LOG_INF("Advertising stopped");
    }
    return err;
}

int ble_service_send_data(const uint8_t *data, uint16_t len)
{
    if (!current_conn) {
        return -ENOTCONN;
    }

    struct bt_gatt_notify_params params = {0};
    params.uuid = NULL;
    params.attr = &rentscan_svc.attrs[3];  // TX characteristic
    params.data = data;
    params.len = len;
    params.func = NULL;

    return bt_gatt_notify_cb(current_conn, &params);
}

int ble_service_send_message(const rentscan_msg_t *msg)
{
    if (!msg) {
        return -EINVAL;
    }

    return ble_service_send_data((const uint8_t *)msg, sizeof(rentscan_msg_t));
}

bool ble_service_is_connected(void)
{
    return current_conn != NULL;
}

int ble_service_disconnect(void)
{
    if (!current_conn) {
        return -ENOTCONN;
    }

    return bt_conn_disconnect(current_conn, BT_HCI_ERR_REMOTE_USER_TERM_CONN);
}
```

## src/ble_service.h
```c
/**
 * @file ble_service.h
 * @brief BLE service functionality for the main device
 */

#ifndef BLE_SERVICE_H
#define BLE_SERVICE_H

#include <zephyr/types.h>
#include <stdbool.h>
#include <stddef.h>
#include "../../common/include/rentscan_protocol.h"

/**
 * @brief Callback for received BLE data
 * 
 * @param data Pointer to data buffer
 * @param len Length of data
 */
typedef void (*ble_data_received_cb_t)(const uint8_t *data, uint16_t len);

/**
 * @brief Initialize the BLE service
 * 
 * @param data_received_cb Callback function to be called when data is received
 * @return int 0 on success, negative error code otherwise
 */
int ble_service_init(ble_data_received_cb_t data_received_cb);

/**
 * @brief Start BLE advertising
 * 
 * @param fast Use fast advertising interval if true, slow if false
 * @return int 0 on success, negative error code otherwise
 */
int ble_service_start_advertising(bool fast);

/**
 * @brief Stop BLE advertising
 * 
 * @return int 0 on success, negative error code otherwise
 */
int ble_service_stop_advertising(void);

/**
 * @brief Send data over BLE
 * 
 * @param data Pointer to data buffer
 * @param len Length of data
 * @return int 0 on success, negative error code otherwise
 */
int ble_service_send_data(const uint8_t *data, uint16_t len);

/**
 * @brief Send a RentScan message over BLE
 * 
 * @param msg Pointer to RentScan message
 * @return int 0 on success, negative error code otherwise
 */
int ble_service_send_message(const rentscan_msg_t *msg);

/**
 * @brief Get BLE connection status
 * 
 * @return true if connected
 * @return false if not connected
 */
bool ble_service_is_connected(void);

/**
 * @brief Disconnect from current BLE connection
 * 
 * @return int 0 on success, negative error code otherwise
 */
int ble_service_disconnect(void);

#endif /* BLE_SERVICE_H */ 
```

## src/nfc_handler.c
```c
#include <zephyr/kernel.h>
#include <zephyr/logging/log.h>
#include <zephyr/device.h>
#include <nrfx_nfct.h>
#include <nfc_t2t_lib.h>
#include <nfc/t2t/parser.h>
#include <nfc/ndef/msg.h>
#include <nfc/ndef/text_rec.h>
#include "nfc_handler.h"

LOG_MODULE_REGISTER(nfc_handler, LOG_LEVEL_INF);

#define NFC_TAG_DATA_MAX_LEN 1024
#define NFC_POLL_INTERVAL K_MSEC(100)

static nfc_tag_callback_t tag_callback;
static bool is_polling = false;
static struct k_work_delayable poll_work;
static uint8_t tag_data_buf[NFC_TAG_DATA_MAX_LEN];

/* NDEF message buffer */
static uint8_t ndef_msg_buf[NFC_TAG_DATA_MAX_LEN];
static uint32_t len;

/* Default NDEF message */
static const uint8_t en_code[] = {'e', 'n'};
static const uint8_t en_payload[] = "ItemID: 001";

/* NFC callback from T2T lib */
static void nfc_callback(void *context,
                        nfc_t2t_event_t event,
                        const uint8_t *data,
                        size_t data_length)
{
    int err;
    char item_id[16] = "001"; // Default item ID
    
    switch (event) {
    case NFC_T2T_EVENT_FIELD_ON:
        LOG_INF("NFC field detected");
        break;

    case NFC_T2T_EVENT_FIELD_OFF:
        LOG_INF("NFC field lost");
        break;

    case NFC_T2T_EVENT_DATA_READ:
        LOG_INF("NFC data read: ItemID: %s", item_id);
        
        // Call the registered callback with the item ID
        if (tag_callback) {
            // Extract item ID from hardcoded value for demonstration
            // In a real implementation, this would parse the NDEF record
            uint8_t id_len = strlen(item_id);
            tag_callback((const uint8_t *)item_id, id_len, NULL, 0);
        }
        break;

    default:
        break;
    }
}

static void poll_work_handler(struct k_work *work)
{
    if (is_polling) {
        // Reschedule polling work
        k_work_schedule(&poll_work, NFC_POLL_INTERVAL);
    }
}

int nfc_handler_init(nfc_tag_callback_t tag_detected_cb)
{
    int err;

    tag_callback = tag_detected_cb;

    // Initialize NFC Type 2 Tag library
    nfc_t2t_setup(nfc_callback, NULL);

    // Initialize default NDEF message
    NFC_NDEF_MSG_DEF(welcome_msg, 1);
    NFC_NDEF_TEXT_RECORD_DESC_DEF(welcome_text,
                                 UTF_8,
                                 en_code,
                                 sizeof(en_code),
                                 en_payload,
                                 sizeof(en_payload));

    err = nfc_ndef_msg_record_add(&NFC_NDEF_MSG(welcome_msg),
                                 &NFC_NDEF_TEXT_RECORD_DESC(welcome_text));
    if (err) {
        LOG_ERR("Cannot add NDEF record (err %d)", err);
        return err;
    }

    len = sizeof(ndef_msg_buf);
    err = nfc_ndef_msg_encode(&NFC_NDEF_MSG(welcome_msg),
                             ndef_msg_buf,
                             &len);
    if (err) {
        LOG_ERR("Cannot encode NDEF message (err %d)", err);
        return err;
    }

    // Set encoded message as the NFC payload
    err = nfc_t2t_payload_set(ndef_msg_buf, len);
    if (err) {
        LOG_ERR("Cannot set payload (err %d)", err);
        return err;
    }

    // Initialize polling work
    k_work_init_delayable(&poll_work, poll_work_handler);

    LOG_INF("NFC handler initialized");
    return 0;
}

int nfc_handler_start_polling(void)
{
    if (is_polling) {
        return 0;
    }

    int err = nfc_t2t_emulation_start();
    if (err) {
        LOG_ERR("Cannot start T2T emulation (err %d)", err);
        return err;
    }

    is_polling = true;
    k_work_schedule(&poll_work, K_NO_WAIT);
    LOG_INF("NFC polling started");
    return 0;
}

int nfc_handler_stop_polling(void)
{
    if (!is_polling) {
        return 0;
    }

    nfc_t2t_emulation_stop();
    is_polling = false;
    k_work_cancel_delayable(&poll_work);
    LOG_INF("NFC polling stopped");
    return 0;
}

int nfc_handler_write_tag(const uint8_t *data, size_t data_len)
{
    if (!data || data_len == 0 || data_len > NFC_TAG_DATA_MAX_LEN) {
        return -EINVAL;
    }

    int err;

    // Create NDEF message with text record
    NFC_NDEF_MSG_DEF(ndef_msg, 1);
    NFC_NDEF_TEXT_RECORD_DESC_DEF(text_rec,
                                 UTF_8,
                                 en_code,
                                 sizeof(en_code),
                                 data,
                                 data_len);

    err = nfc_ndef_msg_record_add(&NFC_NDEF_MSG(ndef_msg),
                                 &NFC_NDEF_TEXT_RECORD_DESC(text_rec));
    if (err) {
        LOG_ERR("Cannot add NDEF record (err %d)", err);
        return err;
    }

    len = sizeof(ndef_msg_buf);
    err = nfc_ndef_msg_encode(&NFC_NDEF_MSG(ndef_msg),
                             ndef_msg_buf,
                             &len);
    if (err) {
        LOG_ERR("Cannot encode message (err %d)", err);
        return err;
    }

    err = nfc_t2t_payload_set(ndef_msg_buf, len);
    if (err) {
        LOG_ERR("Cannot set payload (err %d)", err);
        return err;
    }

    LOG_INF("Tag write successful");
    return 0;
}

bool nfc_handler_is_active(void)
{
    return is_polling;
}
```

## src/nfc_handler.h
```c
/**
 * @file nfc_handler.h
 * @brief NFC tag reading and writing functionality
 */

#ifndef NFC_HANDLER_H
#define NFC_HANDLER_H

#include <zephyr/kernel.h>
#include <stddef.h>
#include <stdbool.h>

/**
 * @brief Callback for NFC tag detection/reading
 * 
 * @param tag_id Pointer to tag ID buffer
 * @param tag_id_len Length of tag ID
 * @param tag_data Pointer to tag data buffer (can be NULL if no data)
 * @param tag_data_len Length of tag data
 */
typedef void (*nfc_tag_callback_t)(const uint8_t *tag_id, size_t tag_id_len,
                                   const uint8_t *tag_data, size_t tag_data_len);

/**
 * @brief Initialize the NFC subsystem
 * 
 * @param tag_detected_cb Callback function to be called when a tag is detected
 * @return int 0 on success, negative error code otherwise
 */
int nfc_handler_init(nfc_tag_callback_t tag_detected_cb);

/**
 * @brief Start NFC polling for tags
 * 
 * @return int 0 on success, negative error code otherwise
 */
int nfc_handler_start_polling(void);

/**
 * @brief Stop NFC polling
 * 
 * @return int 0 on success, negative error code otherwise
 */
int nfc_handler_stop_polling(void);

/**
 * @brief Write data to an NFC tag
 * 
 * @param data Pointer to data buffer
 * @param data_len Length of data
 * @return int 0 on success, negative error code otherwise
 */
int nfc_handler_write_tag(const uint8_t *data, size_t data_len);

/**
 * @brief Get the current NFC subsystem status
 * 
 * @return true if NFC is active and polling
 * @return false if NFC is inactive
 */
bool nfc_handler_is_active(void);

#endif /* NFC_HANDLER_H */ 
```

## src/rental_manager.c
```c
#include <zephyr/kernel.h>
#include <zephyr/logging/log.h>
#include <zephyr/settings/settings.h>
#include "rental_manager.h"

LOG_MODULE_REGISTER(rental_manager, LOG_LEVEL_INF);

#define MAX_ACTIVE_RENTALS 10
#define RENTAL_CHECK_INTERVAL K_SECONDS(60)
#define SETTINGS_PREFIX "rental/"

struct rental_entry {
    uint8_t tag_id[MAX_TAG_ID_LEN];
    uint8_t tag_id_len;
    rentscan_status_t status;
    uint32_t start_time;
    uint32_t duration;
};

static struct rental_entry rentals[MAX_ACTIVE_RENTALS];
static uint8_t num_rentals;
static rental_status_cb_t status_callback;
static struct k_work_delayable check_work;

static void send_status_update(const struct rental_entry *entry)
{
    if (!status_callback) {
        return;
    }

    rentscan_msg_t msg = {
        .cmd = CMD_STATUS_RESP,
        .status = entry->status,
        .timestamp = entry->start_time,
        .duration = entry->duration,
        .tag_id_len = entry->tag_id_len
    };
    memcpy(msg.tag_id, entry->tag_id, entry->tag_id_len);

    status_callback(&msg);
}

static struct rental_entry *find_rental(const uint8_t *tag_id, size_t tag_id_len)
{
    for (int i = 0; i < num_rentals; i++) {
        if (rentals[i].tag_id_len == tag_id_len &&
            memcmp(rentals[i].tag_id, tag_id, tag_id_len) == 0) {
            return &rentals[i];
        }
    }
    return NULL;
}

static void check_work_handler(struct k_work *work)
{
    uint32_t now = k_uptime_get_32() / 1000;
    int expired = 0;

    for (int i = 0; i < num_rentals; i++) {
        if (rentals[i].status == STATUS_RENTED) {
            uint32_t end_time = rentals[i].start_time + rentals[i].duration;
            if (now >= end_time) {
                rentals[i].status = STATUS_EXPIRED;
                send_status_update(&rentals[i]);
                expired++;
            }
        }
    }

    if (expired > 0) {
        LOG_INF("%d rentals expired", expired);
    }

    // Schedule next check
    k_work_schedule(&check_work, RENTAL_CHECK_INTERVAL);
}

int rental_manager_init(rental_status_cb_t status_changed_cb)
{
    status_callback = status_changed_cb;
    num_rentals = 0;

    // Initialize periodic check work
    k_work_init_delayable(&check_work, check_work_handler);
    k_work_schedule(&check_work, RENTAL_CHECK_INTERVAL);

    LOG_INF("Rental manager initialized");
    return 0;
}

int rental_manager_process_tag(const uint8_t *tag_id, size_t tag_id_len,
                              const uint8_t *tag_data, size_t tag_data_len)
{
    if (!tag_id || tag_id_len == 0 || tag_id_len > MAX_TAG_ID_LEN) {
        return -EINVAL;
    }

    struct rental_entry *entry = find_rental(tag_id, tag_id_len);
    
    if (!entry && num_rentals < MAX_ACTIVE_RENTALS) {
        // New tag - add to rentals list
        entry = &rentals[num_rentals++];
        memcpy(entry->tag_id, tag_id, tag_id_len);
        entry->tag_id_len = tag_id_len;
        entry->status = STATUS_AVAILABLE;
        entry->start_time = 0;
        entry->duration = 0;
        
        send_status_update(entry);
    }

    return 0;
}

int rental_manager_process_command(const uint8_t *data, uint16_t len)
{
    if (!data || len < sizeof(rentscan_msg_t)) {
        return -EINVAL;
    }

    const rentscan_msg_t *msg = (const rentscan_msg_t *)data;
    struct rental_entry *entry = find_rental(msg->tag_id, msg->tag_id_len);

    if (!entry) {
        LOG_ERR("Unknown tag ID");
        return -ENOENT;
    }

    switch (msg->cmd) {
    case CMD_RENTAL_START:
        if (entry->status != STATUS_AVAILABLE) {
            LOG_WRN("Item not available for rent");
            return -EBUSY;
        }
        entry->status = STATUS_RENTED;
        entry->start_time = msg->timestamp;
        entry->duration = msg->duration;
        break;

    case CMD_RENTAL_END:
        if (entry->status != STATUS_RENTED &&
            entry->status != STATUS_EXPIRED) {
            LOG_WRN("Item not currently rented");
            return -EINVAL;
        }
        entry->status = STATUS_AVAILABLE;
        entry->start_time = 0;
        entry->duration = 0;
        break;

    default:
        LOG_WRN("Unknown command %d", msg->cmd);
        return -EINVAL;
    }

    send_status_update(entry);
    return 0;
}

int rental_manager_check_expirations(void)
{
    uint32_t now = k_uptime_get_32() / 1000;
    int expired = 0;

    for (int i = 0; i < num_rentals; i++) {
        if (rentals[i].status == STATUS_RENTED) {
            uint32_t end_time = rentals[i].start_time + rentals[i].duration;
            if (now >= end_time) {
                rentals[i].status = STATUS_EXPIRED;
                send_status_update(&rentals[i]);
                expired++;
            }
        }
    }

    return expired;
}

int rental_manager_get_status(const uint8_t *tag_id, size_t tag_id_len,
                             rentscan_status_t *status)
{
    if (!tag_id || !status || tag_id_len == 0) {
        return -EINVAL;
    }

    struct rental_entry *entry = find_rental(tag_id, tag_id_len);
    if (!entry) {
        return -ENOENT;
    }

    *status = entry->status;
    return 0;
}
```

## src/rental_manager.h
```c
/**
 * @file rental_manager.h
 * @brief Rental management functionality
 */

#ifndef RENTAL_MANAGER_H
#define RENTAL_MANAGER_H

#include <zephyr/types.h>
#include <stdbool.h>
#include "../../common/include/rentscan_protocol.h"

/**
 * @brief Callback for rental status changes
 * 
 * @param msg Pointer to RentScan message containing status information
 */
typedef void (*rental_status_cb_t)(const rentscan_msg_t *msg);

/**
 * @brief Initialize the rental manager
 * 
 * @param status_changed_cb Callback function for rental status changes
 * @return int 0 on success, negative error code otherwise
 */
int rental_manager_init(rental_status_cb_t status_changed_cb);

/**
 * @brief Process a tag scan event
 * 
 * @param tag_id Pointer to tag ID
 * @param tag_id_len Length of tag ID
 * @param tag_data Pointer to tag data (can be NULL)
 * @param tag_data_len Length of tag data
 * @return int 0 on success, negative error code otherwise
 */
int rental_manager_process_tag(const uint8_t *tag_id, size_t tag_id_len,
                              const uint8_t *tag_data, size_t tag_data_len);

/**
 * @brief Process a command received from the gateway
 * 
 * @param data Pointer to command data
 * @param len Length of command data
 * @return int 0 on success, negative error code otherwise
 */
int rental_manager_process_command(const uint8_t *data, uint16_t len);

/**
 * @brief Check for rental expirations
 * 
 * This function should be called periodically to check for rental expirations
 * 
 * @return int Number of expired rentals found
 */
int rental_manager_check_expirations(void);

/**
 * @brief Get current rental status for a tag
 * 
 * @param tag_id Pointer to tag ID
 * @param tag_id_len Length of tag ID
 * @param status Pointer to status variable to be filled
 * @return int 0 on success, negative error code otherwise
 */
int rental_manager_get_status(const uint8_t *tag_id, size_t tag_id_len,
                             rentscan_status_t *status);

#endif /* RENTAL_MANAGER_H */ 
```
