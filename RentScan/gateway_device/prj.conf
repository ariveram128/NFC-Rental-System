## CMakeLists.txt
```
cmake_minimum_required(VERSION 3.20.0)

find_package(Zephyr REQUIRED HINTS $ENV{ZEPHYR_BASE})
project(rentscan_gateway_device)

# Include directories
include_directories(include)
include_directories(../common/include)

# Sources for this application
target_sources(app PRIVATE
  src/main.c
  src/ble_central.c
  src/gateway_service.c
)

# Add Kconfig overlay
zephyr_include_directories(${CMAKE_CURRENT_SOURCE_DIR}/include)

# Configuration
target_compile_definitions(app PRIVATE
  -DCONFIG_RENTSCAN_GATEWAY_DEVICE=1) 
```

## prj.conf
```kconfig
# General system configuration
CONFIG_HEAP_MEM_POOL_SIZE=8192
CONFIG_ASSERT=y
CONFIG_REBOOT=y
CONFIG_SPEED_OPTIMIZATIONS=y

CONFIG_BT_CTLR_CONN_RSSI=y

# Logging
CONFIG_LOG=y
CONFIG_LOG_DEFAULT_LEVEL=3
CONFIG_LOG_MODE_DEFERRED=y
CONFIG_LOG_BUFFER_SIZE=4096

# Shell configuration
CONFIG_SHELL=y
CONFIG_SHELL_PROMPT_UART="rentscan:~$ "
CONFIG_SHELL_CMDS=y
CONFIG_SHELL_STATS=y
CONFIG_SHELL_HISTORY=y
CONFIG_SHELL_VT100_COLORS=y
CONFIG_SHELL_WILDCARD=y
CONFIG_SHELL_METAKEYS=y

# Enable UART console
CONFIG_CONSOLE=y
CONFIG_UART_CONSOLE=y
CONFIG_SERIAL=y

# UART configuration for backend communication
CONFIG_UART_INTERRUPT_DRIVEN=y
CONFIG_UART_LINE_CTRL=y
CONFIG_UART_ASYNC_API=y

# JSON processing (uncomment if needed for JSON parsing)
# CONFIG_JSON_LIBRARY=y

# Enable Bluetooth
CONFIG_BT=y
CONFIG_BT_CENTRAL=y
CONFIG_BT_OBSERVER=y
CONFIG_BT_DEVICE_NAME="RentScan_Gateway"
CONFIG_BT_DEVICE_APPEARANCE=833
CONFIG_BT_MAX_CONN=1
CONFIG_BT_SMP=y
CONFIG_BT_L2CAP_TX_MTU=247
CONFIG_BT_BUF_ACL_TX_SIZE=251
CONFIG_BT_BUF_ACL_RX_SIZE=251
CONFIG_BT_GATT_CLIENT=y
CONFIG_BT_SCAN=y
CONFIG_BT_SCAN_FILTER_ENABLE=y
CONFIG_BT_SCAN_NAME_CNT=1
CONFIG_BT_FILTER_ACCEPT_LIST=y
CONFIG_BT_SETTINGS=y

# Storage for settings
CONFIG_FLASH=y
CONFIG_FLASH_MAP=y
CONFIG_NVS=y
CONFIG_SETTINGS=y
CONFIG_SETTINGS_NVS=y
CONFIG_MPU_ALLOW_FLASH_WRITE=y

# Threading and scheduling
CONFIG_SYSTEM_WORKQUEUE_STACK_SIZE=4096
CONFIG_MAIN_STACK_SIZE=4096
CONFIG_INIT_STACKS=y

# Enable watchdog
CONFIG_WATCHDOG=y

# Enable kernel options useful for debugging
CONFIG_DEBUG=y
CONFIG_DEBUG_THREAD_INFO=y

# USB logging option (commented by default)
# CONFIG_USB_DEVICE_STACK=y
# CONFIG_USB_DEVICE_PRODUCT="RentScan Gateway"
# CONFIG_USB_CDC_ACM=y
# CONFIG_SERIAL=y
# CONFIG_UART_LINE_CTRL=y
# CONFIG_USB_DRIVER_LOG_LEVEL_ERR=y 
```

## src/main.c
```c
/**
 * @file main.c
 * @brief Main application for RentScan gateway device (BLE central + backend connector)
 */

#include <zephyr/kernel.h>
#include <zephyr/logging/log.h>
#include <zephyr/shell/shell.h>
#include <zephyr/settings/settings.h>
#include <string.h>
#include <stdio.h>

#include "../include/gateway_config.h"
#include "ble_central.h"
#include "gateway_service.h"
#include "../../common/include/rentscan_protocol.h"

LOG_MODULE_REGISTER(main, LOG_LEVEL_INF);

/* Define work queue items for various tasks */
static struct k_work_delayable health_check_work;
static struct k_work message_process_work;

/* Buffer for message processing */
static rentscan_msg_t current_msg;
static bool message_ready = false;

/* Error tracking */
static int consecutive_errors = 0;

/**
 * @brief Handler for BLE messages
 */
static void ble_message_handler(const rentscan_msg_t *msg)
{
    /* Copy the message to our buffer */
    memcpy(&current_msg, msg, sizeof(rentscan_msg_t));
    
    /* Process received tag data */
    if (msg->cmd == CMD_STATUS_REQ && msg->tag_id_len > 0) {
        char tag_id_str[MAX_TAG_ID_LEN + 1];
        memcpy(tag_id_str, msg->tag_id, msg->tag_id_len);
        tag_id_str[msg->tag_id_len] = '\0';
        
        LOG_INF("Received tag data from main device: ItemID: %s", tag_id_str);
        
        /* Check if item is already rented */
        rental_info_t *existing = NULL;
        char item_id[MAX_TAG_ID_LEN + 1];
        
        /* Convert binary tag ID to string for lookup */
        snprintf(item_id, sizeof(item_id), "%.*s", msg->tag_id_len, msg->tag_id);
        
        /* Find rental */
        rentscan_status_t status;
        if (gateway_service_get_rental_status(item_id, &status) == 0) {
            if (status == STATUS_RENTED) {
                /* Item is rented, end the rental */
                LOG_INF("Item %s is currently rented. Ending rental.", item_id);
                gateway_service_end_rental(item_id);
            } else {
                /* Item is not rented, start a new rental */
                LOG_INF("Item %s is available. Starting rental.", item_id);
                gateway_service_start_rental(item_id, "auto_user", 300); /* 5 minute rental */
            }
        }
    }
    
    /* Signal that we have a message ready */
    message_ready = true;
    
    /* Process the message in the work queue */
    k_work_submit(&message_process_work);
}

/**
 * @brief Message processing work handler
 */
static void message_process_work_handler(struct k_work *work)
{
    int err;
    
    if (!message_ready) {
        return;
    }
    
    /* Process the message */
    err = gateway_service_process_message(&current_msg);
    if (err) {
        LOG_ERR("Failed to process message: %d", err);
        consecutive_errors++;
        
        if (consecutive_errors >= GATEWAY_ERROR_RESET_THRESHOLD) {
            LOG_WRN("Too many consecutive errors, resetting BLE");
            consecutive_errors = 0;
            ble_central_reset();
        }
    } else {
        consecutive_errors = 0;
    }
    
    /* Mark the message as processed */
    message_ready = false;
}

/**
 * @brief Health check work handler
 */
static void health_check_work_handler(struct k_work *work)
{
    /* Check connection state */
    if (!ble_central_is_connected()) {
        LOG_INF("Not connected to any device, starting scan");
        ble_central_start_scan();
    } else {
        /* Log connection statistics */
        int8_t rssi = 0;
        int8_t tx_power = 0;
        uint16_t conn_interval = 0;
        
        if (ble_central_get_conn_stats(&rssi, &tx_power, &conn_interval) == 0) {
            LOG_INF("Connection stats: RSSI=%d dBm, TX=%d dBm, Interval=%.2f ms",
                   rssi, tx_power, conn_interval * 1.25);
        }
    }
    
    /* Reschedule the work */
    k_work_schedule_for_queue(&k_sys_work_q, &health_check_work,
                            K_MSEC(GATEWAY_HEALTH_CHECK_PERIOD_MS));
}

/* Shell command to add a device to the whitelist */
static int cmd_whitelist_add(const struct shell *shell, size_t argc, char *argv[])
{
    if (argc != 2) {
        shell_print(shell, "Usage: whitelist add <device_address>");
        return -EINVAL;
    }
    
    int err = ble_central_add_to_whitelist(argv[1]);
    if (err) {
        shell_error(shell, "Failed to add device: %d", err);
        return err;
    }
    
    shell_print(shell, "Device added to whitelist: %s", argv[1]);
    return 0;
}

/* Shell command to clear the whitelist */
static int cmd_whitelist_clear(const struct shell *shell, size_t argc, char *argv[])
{
    int err = ble_central_clear_whitelist();
    if (err) {
        shell_error(shell, "Failed to clear whitelist: %d", err);
        return err;
    }
    
    shell_print(shell, "Whitelist cleared");
    return 0;
}

/* Shell command to start scanning */
static int cmd_scan_start(const struct shell *shell, size_t argc, char *argv[])
{
    int err = ble_central_start_scan();
    if (err) {
        shell_error(shell, "Failed to start scan: %d", err);
        return err;
    }
    
    shell_print(shell, "Scan started");
    return 0;
}

/* Shell command to stop scanning */
static int cmd_scan_stop(const struct shell *shell, size_t argc, char *argv[])
{
    int err = ble_central_stop_scan();
    if (err) {
        shell_error(shell, "Failed to stop scan: %d", err);
        return err;
    }
    
    shell_print(shell, "Scan stopped");
    return 0;
}

/* Shell command to disconnect */
static int cmd_disconnect(const struct shell *shell, size_t argc, char *argv[])
{
    int err = ble_central_disconnect();
    if (err) {
        shell_error(shell, "Failed to disconnect: %d", err);
        return err;
    }
    
    shell_print(shell, "Disconnected");
    return 0;
}

/* Shell command to reset the BLE stack */
static int cmd_ble_reset(const struct shell *shell, size_t argc, char *argv[])
{
    int err = ble_central_reset();
    if (err) {
        shell_error(shell, "Failed to reset BLE: %d", err);
        return err;
    }
    
    shell_print(shell, "BLE reset complete");
    return 0;
}

/* Shell command to set configuration */
static int cmd_config_set(const struct shell *shell, size_t argc, char *argv[])
{
    if (argc != 3) {
        shell_print(shell, "Usage: config set <key> <value>");
        return -EINVAL;
    }
    
    int err = gateway_service_set_config(argv[1], argv[2]);
    if (err) {
        shell_error(shell, "Failed to set config: %d", err);
        return err;
    }
    
    shell_print(shell, "Config set: %s=%s", argv[1], argv[2]);
    return 0;
}

/* Shell command to get configuration */
static int cmd_config_get(const struct shell *shell, size_t argc, char *argv[])
{
    if (argc != 2) {
        shell_print(shell, "Usage: config get <key>");
        return -EINVAL;
    }
    
    char value[64] = {0};
    int err = gateway_service_get_config(argv[1], value, sizeof(value));
    if (err < 0) {
        shell_error(shell, "Failed to get config: %d", err);
        return err;
    }
    
    shell_print(shell, "Config: %s=%s", argv[1], value);
    return 0;
}

/* Shell command to show status */
static int cmd_status(const struct shell *shell, size_t argc, char *argv[])
{
    shell_print(shell, "BLE Central Status:");
    shell_print(shell, "  Connected: %s", ble_central_is_connected() ? "yes" : "no");
    
    if (ble_central_is_connected()) {
        int8_t rssi = 0;
        int8_t tx_power = 0;
        uint16_t conn_interval = 0;
        
        if (ble_central_get_conn_stats(&rssi, &tx_power, &conn_interval) == 0) {
            shell_print(shell, "  RSSI: %d dBm", rssi);
            shell_print(shell, "  TX Power: %d dBm", tx_power);
            shell_print(shell, "  Conn Interval: %.2f ms", conn_interval * 1.25);
        }
    }
    
    shell_print(shell, "Gateway Service Status:");
    shell_print(shell, "  Backend Connected: %s", gateway_service_is_connected() ? "yes" : "no");
    shell_print(shell, "  Error Count: %d", gateway_service_get_error_count());
    
    /* Get queue count if available */
    char queue_count[16] = {0};
    if (gateway_service_get_config("queue_count", queue_count, sizeof(queue_count)) > 0) {
        shell_print(shell, "  Message Queue: %s", queue_count);
    }
    
    /* Get active rental count */
    char rental_count[16] = {0};
    if (gateway_service_get_config("rental_count", rental_count, sizeof(rental_count)) > 0) {
        shell_print(shell, "  Active Rentals: %s", rental_count);
    }
    
    return 0;
}

/* Shell command to manage backend connection */
static int cmd_backend(const struct shell *shell, size_t argc, char *argv[])
{
    if (argc != 2) {
        shell_print(shell, "Usage: backend <connect|disconnect>");
        return -EINVAL;
    }
    
    if (strcmp(argv[1], "connect") == 0) {
        int err = gateway_service_set_config("backend_connect", "true");
        if (err) {
            shell_error(shell, "Failed to connect to backend: %d", err);
            return err;
        }
        shell_print(shell, "Backend connection requested");
        return 0;
    } else if (strcmp(argv[1], "disconnect") == 0) {
        int err = gateway_service_set_config("backend_connect", "false");
        if (err) {
            shell_error(shell, "Failed to disconnect from backend: %d", err);
            return err;
        }
        shell_print(shell, "Backend disconnection requested");
        return 0;
    } else {
        shell_error(shell, "Unknown command: %s", argv[1]);
        shell_print(shell, "Usage: backend <connect|disconnect>");
        return -EINVAL;
    }
}

/* Shell command to reset error count */
static int cmd_reset_errors(const struct shell *shell, size_t argc, char *argv[])
{
    gateway_service_reset_error_count();
    shell_print(shell, "Error count reset");
    return 0;
}

/* Shell command to start a rental */
static int cmd_rental_start(const struct shell *shell, size_t argc, char *argv[])
{
    if (argc < 4) {
        shell_print(shell, "Usage: rental start <item_id> <user_id> <duration_seconds>");
        return -EINVAL;
    }
    
    const char *item_id = argv[1];
    const char *user_id = argv[2];
    uint32_t duration = strtoul(argv[3], NULL, 10);
    
    int err = gateway_service_start_rental(item_id, user_id, duration);
    if (err) {
        if (err == -EBUSY) {
            shell_error(shell, "Item %s is already rented", item_id);
        } else {
            shell_error(shell, "Failed to start rental: %d", err);
        }
        return err;
    }
    
    shell_print(shell, "Rental started for item %s by user %s for %u seconds", 
               item_id, user_id, duration);
    return 0;
}

/* Shell command to end a rental */
static int cmd_rental_end(const struct shell *shell, size_t argc, char *argv[])
{
    if (argc != 2) {
        shell_print(shell, "Usage: rental end <item_id>");
        return -EINVAL;
    }
    
    const char *item_id = argv[1];
    
    int err = gateway_service_end_rental(item_id);
    if (err) {
        if (err == -ENOENT) {
            shell_error(shell, "No active rental found for item %s", item_id);
        } else {
            shell_error(shell, "Failed to end rental: %d", err);
        }
        return err;
    }
    
    shell_print(shell, "Rental ended for item %s", item_id);
    return 0;
}

/* Shell command to list active rentals */
static int cmd_rental_list(const struct shell *shell, size_t argc, char *argv[])
{
    rental_info_t rentals[8];
    size_t count = 0;
    
    int err = gateway_service_get_active_rentals(rentals, ARRAY_SIZE(rentals), &count);
    if (err) {
        shell_error(shell, "Failed to get active rentals: %d", err);
        return err;
    }
    
    if (count == 0) {
        shell_print(shell, "No active rentals");
        return 0;
    }
    
    shell_print(shell, "Active Rentals (%zu):", count);
    for (size_t i = 0; i < count; i++) {
        const rental_info_t *rental = &rentals[i];
        uint32_t current_time = k_uptime_get_32() / 1000;
        uint32_t elapsed = current_time - rental->start_time;
        uint32_t remaining = (elapsed < rental->duration) ? 
                              (rental->duration - elapsed) : 0;
        
        shell_print(shell, "  Item: %s", rental->item_id);
        shell_print(shell, "    User: %s", rental->user_id);
        shell_print(shell, "    Elapsed: %u seconds", elapsed);
        shell_print(shell, "    Remaining: %u seconds", remaining);
        shell_print(shell, "    Status: %s", 
                  remaining > 0 ? "Active" : "Expired");
    }
    
    return 0;
}

/* Shell command for rental management */
static int cmd_rental(const struct shell *shell, size_t argc, char *argv[])
{
    if (argc == 1) {
        shell_error(shell, "Missing subcommand");
        shell_print(shell, "Usage: rental <start|end|list>");
        return -EINVAL;
    }
    
    if (strcmp(argv[1], "start") == 0) {
        return cmd_rental_start(shell, argc - 1, &argv[1]);
    } else if (strcmp(argv[1], "end") == 0) {
        return cmd_rental_end(shell, argc - 1, &argv[1]);
    } else if (strcmp(argv[1], "list") == 0) {
        return cmd_rental_list(shell, argc - 1, &argv[1]);
    } else {
        shell_error(shell, "Unknown subcommand: %s", argv[1]);
        shell_print(shell, "Usage: rental <start|end|list>");
        return -EINVAL;
    }
}

/* Define shell commands */
SHELL_STATIC_SUBCMD_SET_CREATE(whitelist_cmds,
    SHELL_CMD(add, NULL, "Add device to whitelist", cmd_whitelist_add),
    SHELL_CMD(clear, NULL, "Clear whitelist", cmd_whitelist_clear),
    SHELL_SUBCMD_SET_END
);

SHELL_STATIC_SUBCMD_SET_CREATE(scan_cmds,
    SHELL_CMD(start, NULL, "Start scanning", cmd_scan_start),
    SHELL_CMD(stop, NULL, "Stop scanning", cmd_scan_stop),
    SHELL_SUBCMD_SET_END
);

SHELL_STATIC_SUBCMD_SET_CREATE(config_cmds,
    SHELL_CMD(set, NULL, "Set configuration", cmd_config_set),
    SHELL_CMD(get, NULL, "Get configuration", cmd_config_get),
    SHELL_SUBCMD_SET_END
);

SHELL_STATIC_SUBCMD_SET_CREATE(sub_cmds,
    SHELL_CMD(whitelist, &whitelist_cmds, "Manage whitelist", NULL),
    SHELL_CMD(scan, &scan_cmds, "Control scanning", NULL),
    SHELL_CMD(disconnect, NULL, "Disconnect from device", cmd_disconnect),
    SHELL_CMD(reset, NULL, "Reset BLE stack", cmd_ble_reset),
    SHELL_CMD(config, &config_cmds, "Manage configuration", NULL),
    SHELL_CMD(status, NULL, "Show status", cmd_status),
    SHELL_CMD(backend, NULL, "Control backend connection", cmd_backend),
    SHELL_CMD(reset_errors, NULL, "Reset error count", cmd_reset_errors),
    SHELL_CMD(rental, NULL, "Manage rentals", cmd_rental),
    SHELL_SUBCMD_SET_END
);

SHELL_CMD_REGISTER(rentscan, &sub_cmds, "RentScan Gateway Commands", NULL);

int main(void)
{
    int err;
    
    LOG_INF("RentScan gateway starting");
    
    /* Initialize work queue items */
    k_work_init(&message_process_work, message_process_work_handler);
    k_work_init_delayable(&health_check_work, health_check_work_handler);
    
    /* Initialize the gateway service */
    err = gateway_service_init();
    if (err) {
        LOG_ERR("Failed to initialize gateway service: %d", err);
        return -1;
    }
    
    /* Initialize the BLE central */
    err = ble_central_init(ble_message_handler);
    if (err) {
        LOG_ERR("Failed to initialize BLE central: %d", err);
        return -1;
    }

    /* Load settings - required for BLE address */
    if (IS_ENABLED(CONFIG_SETTINGS)) {
        settings_load();
        LOG_INF("Settings loaded");
    }
    
    /* Wait for BLE stack to fully initialize */
    k_sleep(K_MSEC(100));
    
    /* Start scanning for devices */
    err = ble_central_start_scan();
    if (err) {
        if (err == -EAGAIN) {
            LOG_WRN("BLE stack busy, retrying scan in 2s...");
            k_sleep(K_MSEC(2000));
            err = ble_central_start_scan();
            if (err) {
                LOG_ERR("Second scan attempt failed: %d", err);
            }
        } else {
            LOG_ERR("Failed to start scanning: %d", err);
        }
        /* Continue execution regardless of scan error */
    }
    
    /* Schedule health check */
    k_work_schedule_for_queue(&k_sys_work_q, &health_check_work,
                            K_MSEC(GATEWAY_HEALTH_CHECK_PERIOD_MS));
    
    LOG_INF("RentScan gateway initialized");
    
    return 0;
}
```

## include/gateway_config.h
```c
/**
 * @file gateway_config.h
 * @brief Configuration parameters for the gateway device (BLE central + backend connector)
 */

#ifndef GATEWAY_CONFIG_H
#define GATEWAY_CONFIG_H

/** BLE configuration */
#define BLE_SCAN_INTERVAL 0x0060      /**< Scan interval (60 ms) */
#define BLE_SCAN_WINDOW 0x0050        /**< Scan window (50 ms) - Increased for better discovery */
#define BLE_SCAN_TIMEOUT_MS 10000     /**< Scan timeout in milliseconds (10 seconds) - Increased */
#define BLE_CONN_RETRY_LIMIT 5        /**< Maximum connection retry attempts - Increased */
#define BLE_CONN_RETRY_DELAY_MS 2000  /**< Delay between connection attempts (ms) - Increased */
#define BLE_CONN_SUPERVISION_TIMEOUT 800 /**< Connection supervision timeout (8 seconds) - Increased */

/** Gateway behavior configuration */
#define GATEWAY_RECONNECT_DELAY_MS 3000 /**< Delay before reconnecting after disconnect (ms) */
#define GATEWAY_HEALTH_CHECK_PERIOD_MS 30000 /**< Period for health checks (ms) */
#define GATEWAY_ERROR_RESET_THRESHOLD 5  /**< Number of consecutive errors before reset */

#endif /* GATEWAY_CONFIG_H */
```

## src/ble_central.c
```c
#include <zephyr/kernel.h>
#include <zephyr/bluetooth/bluetooth.h>
#include <zephyr/bluetooth/hci.h>
#include <zephyr/bluetooth/conn.h>
#include <zephyr/bluetooth/uuid.h>
#include <zephyr/bluetooth/gatt.h>
#include <zephyr/logging/log.h>
#include <bluetooth/gatt_dm.h>
#include <bluetooth/scan.h>
#include "ble_central.h"
#include <zephyr/sys/byteorder.h>
#include <zephyr/bluetooth/hci_vs.h>
#include "../include/gateway_config.h"
#include "../../common/include/rentscan_protocol.h"

LOG_MODULE_REGISTER(ble_central, LOG_LEVEL_INF);

// Make these variables accessible to shell_commands.c
struct bt_conn *current_conn;
struct bt_gatt_discover_params discover_params;
struct bt_gatt_subscribe_params subscribe_params;
uint16_t nus_rx_handle;
uint16_t nus_tx_handle;

static ble_msg_received_cb_t msg_callback;
static bool scanning = false;
static int consecutive_errors = 0;

static void start_scan(void);
static void error_recovery(void);

static uint8_t notify_handler(struct bt_conn *conn,
                          struct bt_gatt_subscribe_params *params,
                          const void *data, uint16_t length)
{
    if (!data) {
        LOG_INF("Unsubscribed from notifications");
        params->value_handle = 0;
        return BT_GATT_ITER_STOP;
    }

    if (msg_callback && length >= sizeof(rentscan_msg_t)) {
        msg_callback((const rentscan_msg_t *)data);
    }

    return BT_GATT_ITER_CONTINUE;
}

static bool check_device(struct bt_data *data, void *user_data)
{
    bool *found = (bool *)user_data;
    
    if (data->type == BT_DATA_NAME_COMPLETE) {
        if (data->data_len == strlen(RENTSCAN_DEVICE_NAME) &&
            memcmp(data->data, RENTSCAN_DEVICE_NAME, data->data_len) == 0) {
            *found = true;
        }
    } else if (data->type == BT_DATA_UUID128_ALL) {
        uint8_t uuid[] = {
            BT_UUID_128_ENCODE(0x18ee2ef5, 0x263d, 0x4559, 0x953c, 0xd66077c89ae6)
        };
        if (data->data_len >= 16 && memcmp(data->data, uuid, 16) == 0) {
            *found = true;
        }
    }
    return true;
}

static void device_found(const bt_addr_le_t *addr, int8_t rssi, uint8_t type,
                        struct net_buf_simple *ad)
{
    char addr_str[BT_ADDR_LE_STR_LEN];
    bt_addr_le_to_str(addr, addr_str, sizeof(addr_str));
    int err;

    // Only look for connectable advertising
    if (type != BT_GAP_ADV_TYPE_ADV_IND &&
        type != BT_GAP_ADV_TYPE_ADV_DIRECT_IND) {
        return;
    }

    // Check if this is a RentScan device
    bool found = false;
    bt_data_parse(ad, check_device, &found);
    
    if (!found) {
        return;
    }

    // Check if we're already connected or have a valid connection object
    if (current_conn) {
        LOG_DBG("Already connected to a device, ignoring %s", addr_str);
        return;
    }

    LOG_INF("Found RentScan device %s, RSSI %d", addr_str, rssi);

    // Stop scanning
    err = bt_le_scan_stop();
    if (err) {
        LOG_ERR("Stop scan failed (err %d)", err);
        return;
    }

    scanning = false;

    // Create connection parameters
    struct bt_conn_le_create_param create_param = BT_CONN_LE_CREATE_PARAM_INIT(
        BT_CONN_LE_OPT_NONE,
        BT_GAP_SCAN_FAST_INTERVAL,
        BT_GAP_SCAN_FAST_WINDOW);

    // Connection parameters
    struct bt_le_conn_param conn_param = {
        .interval_min = BT_GAP_INIT_CONN_INT_MIN,
        .interval_max = BT_GAP_INIT_CONN_INT_MAX,
        .latency = 0,
        .timeout = BLE_CONN_SUPERVISION_TIMEOUT
    };

    // Connect to device
    err = bt_conn_le_create(addr, &create_param, &conn_param, &current_conn);
    if (err) {
        LOG_ERR("Create connection failed (err %d)", err);
        scanning = false;
        start_scan();
        return;
    }

    LOG_INF("Connection pending");
}

static uint8_t discover_func(struct bt_conn *conn,
                         const struct bt_gatt_attr *attr,
                         struct bt_gatt_discover_params *params)
{
    int err;

    if (!attr) {
        LOG_INF("Discover complete - attr is NULL");
        
        // Workaround: If we've discovered the primary service but not the characteristics,
        // try to manually set up the subscription
        if (nus_tx_handle == 0) {
            LOG_WRN("Incomplete discovery. Using manual subscription...");
            
            // We'll assume handle values based on the found service
            uint16_t primary_handle = discover_params.start_handle - 1;
            LOG_INF("Primary service was at handle %d", primary_handle);
            
            // Typical handle layout: Primary(n), RX(n+2, value n+3), TX(n+4, value n+5), CCC(n+6)
            nus_rx_handle = primary_handle + 3;
            nus_tx_handle = primary_handle + 5;
            
            LOG_INF("Using estimated handles: RX=%d, TX=%d, CCC=%d", 
                    nus_rx_handle, nus_tx_handle, primary_handle + 6);
            
            // Set up subscription with estimated CCC handle
            subscribe_params.notify = notify_handler;
            subscribe_params.value = BT_GATT_CCC_NOTIFY;
            subscribe_params.value_handle = nus_tx_handle;
            subscribe_params.ccc_handle = primary_handle + 6;
            
            err = bt_gatt_subscribe(conn, &subscribe_params);
            if (err && err != -EALREADY) {
                LOG_ERR("Manual subscribe failed (err %d)", err);
            } else {
                LOG_INF("Manual subscription attempt successful");
            }
        }
        
        (void)memset(params, 0, sizeof(*params));
        return BT_GATT_ITER_STOP;
    }

    LOG_INF("[ATTRIBUTE] handle %u, UUID: %s", attr->handle, bt_uuid_str(attr->uuid));

    if (!bt_uuid_cmp(discover_params.uuid, BT_UUID_RENTSCAN)) {
        LOG_INF("RentScan service found at handle %u, discovering RX characteristic", attr->handle);
        discover_params.uuid = BT_UUID_RENTSCAN_RX;
        discover_params.start_handle = attr->handle + 1;
        discover_params.end_handle = BT_ATT_LAST_ATTRIBUTE_HANDLE;
        discover_params.type = BT_GATT_DISCOVER_CHARACTERISTIC;

        err = bt_gatt_discover(conn, &discover_params);
        if (err) {
            LOG_ERR("Discover RX characteristic failed (err %d)", err);
            
            // Try the workaround directly
            if (err == -ENOENT || err == -ENOMEM) {
                LOG_WRN("Trying manual subscription due to discovery error");
                uint16_t primary_handle = attr->handle;
                nus_rx_handle = primary_handle + 3;
                nus_tx_handle = primary_handle + 5;
                
                subscribe_params.notify = notify_handler;
                subscribe_params.value = BT_GATT_CCC_NOTIFY;
                subscribe_params.value_handle = nus_tx_handle;
                subscribe_params.ccc_handle = primary_handle + 6;
                
                err = bt_gatt_subscribe(conn, &subscribe_params);
                if (err && err != -EALREADY) {
                    LOG_ERR("Manual subscribe failed (err %d)", err);
                } else {
                    LOG_INF("Manual subscription successful");
                }
            }
        }
        return BT_GATT_ITER_STOP;
    } 
    
    if (!bt_uuid_cmp(discover_params.uuid, BT_UUID_RENTSCAN_RX)) {
        LOG_INF("RX characteristic found at handle %u", attr->handle);
        nus_rx_handle = bt_gatt_attr_value_handle(attr);
        LOG_INF("RX value handle: %u", nus_rx_handle);
        
        discover_params.uuid = BT_UUID_RENTSCAN_TX;
        discover_params.start_handle = attr->handle + 1;
        discover_params.end_handle = BT_ATT_LAST_ATTRIBUTE_HANDLE;
        discover_params.type = BT_GATT_DISCOVER_CHARACTERISTIC;

        err = bt_gatt_discover(conn, &discover_params);
        if (err) {
            LOG_ERR("Discover TX characteristic failed (err %d)", err);
        }
        return BT_GATT_ITER_STOP;
    } 
    
    if (!bt_uuid_cmp(discover_params.uuid, BT_UUID_RENTSCAN_TX)) {
        LOG_INF("TX characteristic found at handle %u", attr->handle);
        nus_tx_handle = bt_gatt_attr_value_handle(attr);
        LOG_INF("TX value handle: %u", nus_tx_handle);

        /* Find the CCC descriptor */
        discover_params.uuid = BT_UUID_GATT_CCC;
        discover_params.start_handle = attr->handle + 1;
        discover_params.end_handle = BT_ATT_LAST_ATTRIBUTE_HANDLE;
        discover_params.type = BT_GATT_DISCOVER_DESCRIPTOR;
        
        err = bt_gatt_discover(conn, &discover_params);
        if (err) {
            LOG_ERR("Discover CCC failed (err %d)", err);
            
            // Try with estimated CCC handle
            LOG_WRN("Trying with estimated CCC handle");
            subscribe_params.notify = notify_handler;
            subscribe_params.value = BT_GATT_CCC_NOTIFY;
            subscribe_params.value_handle = nus_tx_handle;
            subscribe_params.ccc_handle = attr->handle + 2;
            
            err = bt_gatt_subscribe(conn, &subscribe_params);
            if (err && err != -EALREADY) {
                LOG_ERR("Subscribe with estimated handle failed (err %d)", err);
            } else {
                LOG_INF("Subscription with estimated handle successful");
            }
        }
        return BT_GATT_ITER_STOP;
    }
    
    if (!bt_uuid_cmp(discover_params.uuid, BT_UUID_GATT_CCC)) {
        LOG_INF("CCC descriptor found at handle %u, subscribing to notifications", attr->handle);
        
        subscribe_params.notify = notify_handler;
        subscribe_params.value = BT_GATT_CCC_NOTIFY;
        subscribe_params.value_handle = nus_tx_handle;
        subscribe_params.ccc_handle = attr->handle;
        LOG_INF("Setting up subscription with value_handle=%u, ccc_handle=%u", 
                nus_tx_handle, attr->handle);

        err = bt_gatt_subscribe(conn, &subscribe_params);
        if (err && err != -EALREADY) {
            LOG_ERR("Subscribe failed (err %d)", err);
        } else {
            LOG_INF("Successfully subscribed to notifications");
        }
        
        return BT_GATT_ITER_STOP;
    }

    return BT_GATT_ITER_STOP;
}

static void connected(struct bt_conn *conn, uint8_t err)
{
    char addr[BT_ADDR_LE_STR_LEN];
    bt_addr_le_to_str(bt_conn_get_dst(conn), addr, sizeof(addr));

    if (err) {
        LOG_ERR("Failed to connect to %s (%u)", addr, err);
        scanning = false;
        start_scan();
        return;
    }

    LOG_INF("Connected to device %s", addr);
    current_conn = bt_conn_ref(conn);
    consecutive_errors = 0;

    discover_params.uuid = BT_UUID_RENTSCAN;
    discover_params.func = discover_func;
    discover_params.start_handle = BT_ATT_FIRST_ATTRIBUTE_HANDLE;
    discover_params.end_handle = BT_ATT_LAST_ATTRIBUTE_HANDLE;
    discover_params.type = BT_GATT_DISCOVER_PRIMARY;

    err = bt_gatt_discover(conn, &discover_params);
    if (err) {
        LOG_ERR("Service discovery failed (err %d)", err);
        error_recovery();
    }
}

static void disconnected(struct bt_conn *conn, uint8_t reason)
{
    char addr[BT_ADDR_LE_STR_LEN];
    bt_addr_le_to_str(bt_conn_get_dst(conn), addr, sizeof(addr));

    LOG_INF("Disconnected from %s (reason 0x%02x)", addr, reason);

    if (current_conn) {
        bt_conn_unref(current_conn);
        current_conn = NULL;
    }

    /* Return to scanning */
    scanning = false;
    start_scan();
}

BT_CONN_CB_DEFINE(conn_callbacks) = {
    .connected = connected,
    .disconnected = disconnected,
};

static void start_scan(void)
{
    int err;
    int retry_count = 0;
    const int max_retries = 3;

    if (scanning) {
        LOG_INF("Scan already active");
        return;
    }

    while (retry_count < max_retries) {
        // Configure scan parameters for better discovery
        struct bt_le_scan_param scan_param = {
            .type = BT_LE_SCAN_TYPE_ACTIVE,
            .interval = BLE_SCAN_INTERVAL,
            .window = BLE_SCAN_WINDOW,
            .options = BT_LE_SCAN_OPT_FILTER_DUPLICATE
        };

        err = bt_le_scan_start(&scan_param, device_found);
        if (err == 0) {
            scanning = true;
            LOG_INF("Scanning started successfully");
            return;
        } else if (err == -EAGAIN) {
            retry_count++;
            LOG_WRN("Scan start failed with EAGAIN, retry %d/%d", retry_count, max_retries);
            k_sleep(K_MSEC(1000 * retry_count));
        } else {
            LOG_ERR("Starting scanning failed (err %d)", err);
            return;
        }
    }

    LOG_ERR("Failed to start scan after %d retries", max_retries);
}

static void error_recovery(void)
{
    consecutive_errors++;
    
    if (consecutive_errors >= GATEWAY_ERROR_RESET_THRESHOLD) {
        LOG_WRN("Too many consecutive errors, resetting BLE");
        consecutive_errors = 0;
        ble_central_reset();
    } else {
        if (current_conn) {
            bt_conn_disconnect(current_conn, BT_HCI_ERR_REMOTE_USER_TERM_CONN);
        }
        scanning = false;
        start_scan();
    }
}

int ble_central_init(ble_msg_received_cb_t msg_received_cb)
{
    int err;

    msg_callback = msg_received_cb;

    err = bt_enable(NULL);
    if (err) {
        LOG_ERR("Bluetooth init failed (err %d)", err);
        return err;
    }

    LOG_INF("Bluetooth initialized");
    return 0;
}

int ble_central_start_scan(void)
{
    if (!scanning) {
        start_scan();
    }
    return 0;
}

int ble_central_stop_scan(void)
{
    if (scanning) {
        int err = bt_le_scan_stop();
        if (err) {
            LOG_ERR("Stopping scanning failed (err %d)", err);
            return err;
        }
        scanning = false;
    }
    return 0;
}

int ble_central_send_message(const rentscan_msg_t *msg)
{
    if (!current_conn || !nus_rx_handle) {
        return -ENOTCONN;
    }

    return bt_gatt_write_without_response(current_conn, nus_rx_handle,
                                        msg, sizeof(*msg), false);
}

int ble_central_disconnect(void)
{
    if (current_conn) {
        return bt_conn_disconnect(current_conn, BT_HCI_ERR_REMOTE_USER_TERM_CONN);
    }
    return 0;
}

int ble_central_reset(void)
{
    /* First, properly disconnect and clean up any existing connection */
    if (current_conn) {
        bt_conn_disconnect(current_conn, BT_HCI_ERR_REMOTE_USER_TERM_CONN);
        bt_conn_unref(current_conn);
        current_conn = NULL;
    }

    /* Stop any active scanning */
    if (scanning) {
        bt_le_scan_stop();
        scanning = false;
    }

    LOG_INF("BLE central reset");
    
    /* Restart scanning */
    start_scan();
    return 0;
}

bool ble_central_is_connected(void)
{
    return current_conn != NULL;
}

/* Function to read RSSI using HCI command */
int ble_central_get_conn_stats(int8_t *rssi, int8_t *tx_power, uint16_t *conn_interval)
{
    if (!current_conn) {
        return -ENOTCONN;
    }

    /* Get connection interval from connection info */
    struct bt_conn_info info;
    int err = bt_conn_get_info(current_conn, &info);
    if (err) {
        return err;
    }

    if (conn_interval) {
        *conn_interval = info.le.interval;
    }

    /* Use HCI Read RSSI command to get actual RSSI value */
    if (rssi) {
        struct net_buf *buf, *rsp = NULL;
        struct bt_hci_cp_read_rssi *cp;
        struct bt_hci_rp_read_rssi *rp;
        
        /* Get connection handle - use index instead of non-existent bt_conn_get_id() */
        uint16_t handle = bt_conn_index(current_conn);
        
        /* Create HCI command */
        buf = bt_hci_cmd_create(BT_HCI_OP_READ_RSSI, sizeof(*cp));
        if (!buf) {
            return -ENOBUFS;
        }
        
        /* Fill command parameters - use manual assignment instead of sys_cpu_to_le16 */
        cp = net_buf_add(buf, sizeof(*cp));
        cp->handle = handle; /* No endian conversion needed as this is a local variable */
        
        /* Send command and wait for response */
        err = bt_hci_cmd_send_sync(BT_HCI_OP_READ_RSSI, buf, &rsp);
        if (err) {
            return err;
        }
        
        /* Process response */
        rp = (void *)rsp->data;
        if (rp->status) {
            /* Command failed */
            err = -EIO;
        } else {
            /* The HCI returns RSSI as a signed 8-bit value in dBm */
            *rssi = rp->rssi;
            err = 0;
        }
        
        /* Release response buffer */
        net_buf_unref(rsp);
        
        if (err) {
            return err;
        }
    }

    /* Estimate TX power based on connection parameters */
    if (tx_power) {
        if (info.le.interval < 50) {
            *tx_power = 0;  /* Higher power for fast connections */
        } else {
            *tx_power = -6; /* Lower power for slow connections */
        }
    }

    return 0;
}

int ble_central_add_to_whitelist(const char *addr_str)
{
    // Replace whitelist with filter accept list
    bt_addr_le_t addr;
    int err = bt_addr_le_from_str(addr_str, "random", &addr);
    if (err) {
        return err;
    }
    return bt_le_filter_accept_list_add(&addr);
}

int ble_central_clear_whitelist(void)
{
    // Replace whitelist with filter accept list
    return bt_le_filter_accept_list_clear();
}
```

## src/ble_central.h
```c
/**
 * @file ble_central.h
 * @brief BLE central functionality for the gateway device
 */

#ifndef BLE_CENTRAL_H
#define BLE_CENTRAL_H

#include <zephyr/types.h>
#include <stdbool.h>
#include <stddef.h>
#include "../../common/include/rentscan_protocol.h"

/**
 * @brief Callback for received BLE messages
 * 
 * @param msg Pointer to RentScan message
 */
typedef void (*ble_msg_received_cb_t)(const rentscan_msg_t *msg);

/**
 * @brief Initialize the BLE central
 * 
 * @param msg_received_cb Callback function to be called when a message is received
 * @return int 0 on success, negative error code otherwise
 */
int ble_central_init(ble_msg_received_cb_t msg_received_cb);

/**
 * @brief Start scanning for RentScan devices
 * 
 * @return int 0 on success, negative error code otherwise
 */
int ble_central_start_scan(void);

/**
 * @brief Stop scanning for RentScan devices
 * 
 * @return int 0 on success, negative error code otherwise
 */
int ble_central_stop_scan(void);

/**
 * @brief Send a message to a connected RentScan device
 * 
 * @param msg Pointer to RentScan message
 * @return int 0 on success, negative error code otherwise
 */
int ble_central_send_message(const rentscan_msg_t *msg);

/**
 * @brief Disconnect from the current device
 * 
 * @return int 0 on success, negative error code otherwise
 */
int ble_central_disconnect(void);

/**
 * @brief Reset the BLE stack (in case of irrecoverable errors)
 * 
 * @return int 0 on success, negative error code otherwise
 */
int ble_central_reset(void);

/**
 * @brief Check if connected to a RentScan device
 * 
 * @return true if connected
 * @return false if not connected
 */
bool ble_central_is_connected(void);

/**
 * @brief Get connection quality statistics
 * 
 * @param rssi Pointer to store RSSI value
 * @param tx_power Pointer to store TX power
 * @param conn_interval Pointer to store connection interval
 * @return int 0 on success, negative error code otherwise
 */
int ble_central_get_conn_stats(int8_t *rssi, int8_t *tx_power, uint16_t *conn_interval);

/**
 * @brief Add a device address to the whitelist
 * 
 * @param addr_str String representation of the BLE address
 * @return int 0 on success, negative error code otherwise
 */
int ble_central_add_to_whitelist(const char *addr_str);

/**
 * @brief Clear the device whitelist
 * 
 * @return int 0 on success, negative error code otherwise
 */
int ble_central_clear_whitelist(void);

#endif /* BLE_CENTRAL_H */ 
```

## src/gateway_service.h
```c
/**
 * @file gateway_service.h
 * @brief Gateway service for forwarding data to backend
 */

#ifndef GATEWAY_SERVICE_H
#define GATEWAY_SERVICE_H

#include <zephyr/types.h>
#include "../../common/include/rentscan_protocol.h"

/* Rental information structure */
typedef struct {
    char item_id[MAX_TAG_ID_LEN + 1];  /* Item ID string */
    uint32_t start_time;               /* Start time in seconds (system uptime) */
    uint32_t duration;                 /* Duration in seconds */
    char user_id[16];                  /* User ID string */
    bool active;                       /* Whether rental is active */
} rental_info_t;

/* Gateway service status structure */
typedef struct {
    bool backend_connected;            /* Whether backend is connected */
    uint32_t error_count;              /* Count of errors */
    uint32_t queue_size;               /* Size of message queue */
    uint32_t rental_count;             /* Count of active rentals */
} gateway_service_status_t;

/**
 * @brief Initialize the gateway service
 * 
 * @return int 0 on success, negative error code otherwise
 */
int gateway_service_init(void);

/**
 * @brief Process a received message
 * 
 * This function will forward the message to the backend
 * 
 * @param msg Pointer to RentScan message
 * @return int 0 on success, negative error code otherwise
 */
int gateway_service_process_message(const rentscan_msg_t *msg);

/**
 * @brief Start a new rental
 * 
 * @param item_id Item ID string
 * @param user_id User ID string
 * @param duration Duration in seconds
 * @return int 0 on success, negative error code otherwise
 */
int gateway_service_start_rental(const char *item_id, const char *user_id, uint32_t duration);

/**
 * @brief End an active rental
 * 
 * @param item_id Item ID string
 * @return int 0 on success, negative error code otherwise
 */
int gateway_service_end_rental(const char *item_id);

/**
 * @brief Get rental status for an item
 * 
 * @param item_id Item ID string
 * @param status Pointer to store status
 * @return int 0 on success, negative error code otherwise
 */
int gateway_service_get_rental_status(const char *item_id, rentscan_status_t *status);

/**
 * @brief Get gateway service status
 * 
 * @param status Pointer to store status
 * @return int 0 on success, negative error code otherwise
 */
int gateway_service_get_status(gateway_service_status_t *status);

/**
 * @brief Reset error count
 * 
 * @return int 0 on success, negative error code otherwise
 */
int gateway_service_reset_errors(void);

/**
 * @brief Get rental information by index
 * 
 * @param index Index of rental
 * @param rental Pointer to store rental information
 * @return int 0 on success, negative error code otherwise
 */
int gateway_service_get_rental(uint32_t index, rental_info_t *rental);

/**
 * @brief Connect to backend
 * 
 * @return int 0 on success, negative error code otherwise
 */
int gateway_service_connect_backend(void);

/**
 * @brief Disconnect from backend
 * 
 * @return int 0 on success, negative error code otherwise
 */
int gateway_service_disconnect_backend(void);

#endif /* GATEWAY_SERVICE_H */ 
```
