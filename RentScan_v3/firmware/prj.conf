## CMakeLists.txt
```
# RentScan v3 Firmware
# CMakeLists.txt

cmake_minimum_required(VERSION 3.20.0)

# Find the Zephyr package
find_package(Zephyr REQUIRED HINTS $ENV{ZEPHYR_BASE})

# Set up the project
project(rentscan_v3)

# Add source files
target_sources(app PRIVATE
  src/main.c
  src/nfc_handler.c
  src/rental_service.c
  src/rental_data.c
  src/storage_manager.c
  include/compat/nrf_fstorage_impl.c
)

# Include directories
target_include_directories(app PRIVATE
  include
  include/compat
)

# Preprocessor definitions
target_compile_definitions(app PRIVATE
  NRF52840_XXAA
  ZEPHYR_COMPAT_LAYER
)

# Compiler flags
target_compile_options(app PRIVATE
  -Wall
  -Werror
)

# Add optional zephyr_linker_script() if needed for custom memory layout
# zephyr_linker_script_ifdef(CONFIG_CUSTOM_LINKER_SCRIPT custom_linker.ld)
```

## prj.conf
```kconfig
# General config
CONFIG_NEWLIB_LIBC=y
CONFIG_ASSERT=y
CONFIG_PRINTK=y

# Logging
CONFIG_LOG=y
CONFIG_LOG_DEFAULT_LEVEL=3
CONFIG_LOG_BACKEND_RTT=y
CONFIG_LOG_BACKEND_UART=y
CONFIG_LOG_PRINTK=y

# Bluetooth
CONFIG_BT=y
CONFIG_BT_PERIPHERAL=y
CONFIG_BT_CENTRAL=y
CONFIG_BT_DEVICE_NAME="RentScanNRF"
CONFIG_BT_DEVICE_APPEARANCE=833
CONFIG_BT_MAX_CONN=2
CONFIG_BT_GATT_CLIENT=y
CONFIG_BT_SMP=y

# NFC - Fix undefined symbols
CONFIG_NRFX_NFCT=y
# Remove undefined symbols
# CONFIG_NFC=y
# CONFIG_NFC_T4T_LIB_ENABLED=y
CONFIG_NFC_T2T_NRFXLIB=y
CONFIG_NFC_NDEF=y
CONFIG_NFC_NDEF_MSG=y
CONFIG_NFC_NDEF_RECORD=y
CONFIG_NFC_NDEF_TEXT_RECORD=y

# GPIO
CONFIG_GPIO=y

# Flash storage
CONFIG_FLASH=y
CONFIG_FLASH_PAGE_LAYOUT=y
CONFIG_FLASH_MAP=y
CONFIG_NVS=y
CONFIG_SETTINGS=y
CONFIG_SETTINGS_NVS=y
CONFIG_FCB=y

# UART, console
CONFIG_SERIAL=y
CONFIG_CONSOLE=y
CONFIG_UART_CONSOLE=y

# Power management - Fix warning by disabling
# CONFIG_PM=y
# CONFIG_PM_DEVICE=y

# Thread names
CONFIG_THREAD_NAME=y

# Use external RAM
CONFIG_HEAP_MEM_POOL_SIZE=16384

# Shell (optional for CLI interaction)
CONFIG_SHELL=y
CONFIG_SHELL_PROMPT_UART="rentscan_v3:~$ "
CONFIG_SHELL_CMDS=y

# Enable NFC subsystem and libraries
CONFIG_NFCT_PINS_AS_GPIOS=n
CONFIG_NFC_T2T_NRFXLIB=y
CONFIG_NFC_NDEF=y
CONFIG_NFC_NDEF_MSG=y
CONFIG_NFC_NDEF_RECORD=y
CONFIG_NFC_NDEF_TEXT_RECORD=y
CONFIG_NFC_NDEF_URI_MSG=y
CONFIG_NFC_NDEF_URI_REC=y

# Zephyr modules needed for compat layer
CONFIG_FILE_SYSTEM=y
CONFIG_FILE_SYSTEM_LITTLEFS=y
```

## src/main.c
```c
/**
 * @file main.c
 * @brief RentScan - Wireless NFC Tag Rental System (nRF52840 Edition)
 *
 * This file contains the main application for the RentScan system.
 * It initializes the NFC reader, BLE communication, and handles the
 * rental management logic.
 *
 * Author: Generated Code Example
 */

 #include <stdint.h>
 #include <stdbool.h>
 #include <string.h>
 #include "nordic_common.h"
 #include "nrf.h"
 #include "app_error.h"
 #include "app_timer.h"
 #include "app_button.h"
 #include "nrf_pwr_mgmt.h"
 #include "nrf_log.h"
 #include "nrf_log_ctrl.h"
 #include "nrf_log_default_backends.h"
 #include <zephyr/kernel.h>
 
 // BLE related includes
 // #include "ble_advdata.h" // Old SDK, comment out
 // #include "ble_advertising.h" // Old SDK, comment out
 #include "ble_conn_params.h"
 #include "ble_hci.h"
 #include "ble_srv_common.h"
 #include "ble_dis.h"
 #include "nrf_sdh.h"
 #include "nrf_sdh_soc.h"
 #include "nrf_sdh_ble.h"
 #include "nrf_ble_gatt.h"
 #include "nrf_ble_qwr.h"
 
 // NFC related includes
 #include "nfc_t4t_lib.h"
 #include "nfc_ndef_msg.h"
 #include "nfc_ndef_record.h"
 #include "nfc_ndef_text_rec.h"
 #include "nfc_t4t_ndef_file.h"
 
 // Custom includes
 #include "rental_service.h"
 #include "rental_data.h"
 #include "nfc_handler.h"
 #include "storage_manager.h"
 
 // Macros and definitions
 #define APP_BLE_CONN_CFG_TAG    1                                  /**< Tag identifying the SoftDevice BLE configuration. */
 #define APP_BLE_OBSERVER_PRIO   3                                  /**< BLE observer priority of the application. */
 #define APP_ADV_INTERVAL        300                                /**< The advertising interval (in units of 0.625 ms). */
 #define APP_ADV_DURATION        18000                              /**< The advertising duration (180 seconds) in units of 10 milliseconds. */
 
 #define MIN_CONN_INTERVAL       MSEC_TO_UNITS(100, UNIT_1_25_MS)   /**< Minimum acceptable connection interval (0.1 seconds). */
 #define MAX_CONN_INTERVAL       MSEC_TO_UNITS(200, UNIT_1_25_MS)   /**< Maximum acceptable connection interval (0.2 seconds). */
 #define SLAVE_LATENCY           0                                  /**< Slave latency. */
 #define CONN_SUP_TIMEOUT        MSEC_TO_UNITS(4000, UNIT_10_MS)    /**< Connection supervisory time-out (4 seconds). */
 
 #define FIRST_CONN_PARAMS_UPDATE_DELAY  APP_TIMER_TICKS(5000)      /**< Time from initiating event (connect or start of notification) to first time sd_ble_gap_conn_param_update is called (5 seconds). */
 #define NEXT_CONN_PARAMS_UPDATE_DELAY   APP_TIMER_TICKS(30000)     /**< Time between each call to sd_ble_gap_conn_param_update after the first call (30 seconds). */
 #define MAX_CONN_PARAMS_UPDATE_COUNT    3                          /**< Number of attempts before giving up the connection parameter negotiation. */
 
 #define BUTTON_DETECTION_DELAY          APP_TIMER_TICKS(50)        /**< Delay from a GPIOTE event until a button is reported as pushed (in number of timer ticks). */
 
 // Timers
 APP_TIMER_DEF(m_scan_timer_id);                                    /**< Timer for periodic NFC scanning. */
 #define NFC_SCAN_INTERVAL               APP_TIMER_TICKS(1000)      /**< NFC scan interval (value of 1000 gives approximately 1 second). */
 
 // BLE related variables
 NRF_BLE_GATT_DEF(m_gatt);                                          /**< GATT module instance. */
 NRF_BLE_QWR_DEF(m_qwr);                                            /**< Context for the Queued Write module. */
 // BLE_ADVERTISING_DEF(m_advertising);                                /**< Advertising module instance. */ // Old SDK, comment out
 BLE_RENTAL_SERVICE_DEF(m_rental_service);                          /**< Rental Service instance. */
 
 static uint16_t m_conn_handle = BLE_CONN_HANDLE_INVALID;           /**< Handle of the current connection. */
 // static uint8_t m_adv_handle = BLE_GAP_ADV_SET_HANDLE_NOT_SET;      /**< Advertising handle used to identify an advertising set. */ // Old SDK, comment out
 // static uint8_t m_enc_advdata[BLE_GAP_ADV_SET_DATA_SIZE_MAX];       /**< Buffer for storing an encoded advertising set. */ // Old SDK, comment out
 
 // NFC related variables
 static uint8_t m_ndef_msg_buf[NFC_NDEF_MSG_BUF_SIZE];              /**< Buffer for NDEF message. */
 static nfc_ndef_record_desc_t m_ndef_record;                       /**< NDEF record descriptor. */
 static uint32_t m_ndef_msg_len;                                    /**< Length of the NDEF message. */
 
 // Application variables
 static rental_item_t m_current_item;                               /**< Current rental item being processed. */
 static bool m_nfc_field_active = false;                            /**< Flag indicating if NFC field is active. */
 
 // Function prototypes
 static void log_init(void);
 static void timer_init(void);
 static void buttons_init(void);
 static void power_management_init(void);
 static void ble_stack_init(void);
 static void gap_params_init(void);
 static void gatt_init(void);
 // static void advertising_init(void); // Old SDK, comment out
 static void services_init(void);
 static void conn_params_init(void);
 // static void advertising_start(void); // Old SDK, comment out
 static void nfc_init(void);
 static void nfc_callback(void * p_context, nfc_t4t_event_t event, const uint8_t * p_data, size_t data_length);
 static void scan_timer_handler(void * p_context);
 static void on_rental_write(uint16_t conn_handle, ble_rental_service_t * p_rental_service, const rental_item_t * p_item);
 static void on_rental_evt(ble_rental_evt_t * p_evt);
 
 /**@brief Function for initializing the logging module. */
 static void log_init(void)
 {
     ret_code_t err_code = NRF_LOG_INIT(NULL);
     APP_ERROR_CHECK(err_code);
 
     NRF_LOG_DEFAULT_BACKENDS_INIT();
     NRF_LOG_INFO("RentScan NFC Tag Rental System started.");
 }
 
 /**@brief Function for initializing the timer module. */
 static void timer_init(void)
 {
     ret_code_t err_code = app_timer_init();
     APP_ERROR_CHECK(err_code);
 
     // Create timers
     err_code = app_timer_create(&m_scan_timer_id, APP_TIMER_MODE_REPEATED, scan_timer_handler);
     APP_ERROR_CHECK(err_code);
 }
 
 /**@brief Function for initializing the button module. */
 static void buttons_init(void)
 {
     ret_code_t err_code;
 
     // Configure application button
     static app_button_cfg_t app_buttons[] =
     {
         {BUTTON_1, false, BUTTON_PULL, NULL},
         {BUTTON_2, false, BUTTON_PULL, NULL}
     };
 
     err_code = app_button_init(app_buttons, ARRAY_SIZE(app_buttons), BUTTON_DETECTION_DELAY);
     APP_ERROR_CHECK(err_code);
 
     err_code = app_button_enable();
     APP_ERROR_CHECK(err_code);
 }
 
 /**@brief Function for initializing the power management module. */
 static void power_management_init(void)
 {
     ret_code_t err_code = nrf_pwr_mgmt_init();
     APP_ERROR_CHECK(err_code);
 }
 
 /**@brief Function for initializing the BLE stack. */
 static void ble_stack_init(void)
 {
     ret_code_t err_code;
 
     err_code = nrf_sdh_enable_request();
     APP_ERROR_CHECK(err_code);
 
     // Configure the BLE stack using the default settings.
     uint32_t ram_start = 0;
     err_code = nrf_sdh_ble_default_cfg_set(APP_BLE_CONN_CFG_TAG, &ram_start);
     APP_ERROR_CHECK(err_code);
 
     // Enable BLE stack.
     err_code = nrf_sdh_ble_enable(&ram_start);
     APP_ERROR_CHECK(err_code);
 
     // Register a handler for BLE events.
     NRF_SDH_BLE_OBSERVER(m_ble_observer, APP_BLE_OBSERVER_PRIO, NULL, NULL);
 }
 
 /**@brief Function for initializing the GAP parameters. */
 static void gap_params_init(void)
 {
     ret_code_t              err_code;
     ble_gap_conn_params_t   gap_conn_params;
     ble_gap_conn_sec_mode_t sec_mode;
 
     BLE_GAP_CONN_SEC_MODE_SET_OPEN(&sec_mode);
 
     // Set GAP device name
     err_code = sd_ble_gap_device_name_set(&sec_mode, (const uint8_t *)"RentScanNRF", strlen("RentScanNRF"));
     APP_ERROR_CHECK(err_code);
 
     memset(&gap_conn_params, 0, sizeof(gap_conn_params));
 
     gap_conn_params.min_conn_interval = MIN_CONN_INTERVAL;
     gap_conn_params.max_conn_interval = MAX_CONN_INTERVAL;
     gap_conn_params.slave_latency     = SLAVE_LATENCY;
     gap_conn_params.conn_sup_timeout  = CONN_SUP_TIMEOUT;
 
     err_code = sd_ble_gap_ppcp_set(&gap_conn_params);
     APP_ERROR_CHECK(err_code);
 }
 
 /**@brief Function for initializing the GATT module. */
 static void gatt_init(void)
 {
     ret_code_t err_code = nrf_ble_gatt_init(&m_gatt, NULL);
     APP_ERROR_CHECK(err_code);
 }
 
 /**@brief Function for initializing services that will be used by the application. */
 static void services_init(void)
 {
     ret_code_t err_code;
     ble_rental_service_init_t rental_init;
     ble_dis_init_t dis_init;
     nrf_ble_qwr_init_t qwr_init = {0};
 
     // Initialize Queued Write Module
     qwr_init.error_handler = NULL;
     err_code = nrf_ble_qwr_init(&m_qwr, &qwr_init);
     APP_ERROR_CHECK(err_code);
 
     // Initialize Device Information Service
     memset(&dis_init, 0, sizeof(dis_init));
     ble_srv_ascii_to_utf8(&dis_init.manufact_name_str, (char *)"RentScan Inc.");
     ble_srv_ascii_to_utf8(&dis_init.model_num_str, (char *)"RentScan-NRF-1.0");
 
     dis_init.dis_char_rd_sec = SEC_OPEN;
     err_code = ble_dis_init(&dis_init);
     APP_ERROR_CHECK(err_code);
 
     // Initialize Rental Service
     memset(&rental_init, 0, sizeof(rental_init));
     rental_init.evt_handler = on_rental_evt;
     rental_init.write_handler = on_rental_write;
 
     err_code = ble_rental_service_init(&m_rental_service, &rental_init);
     APP_ERROR_CHECK(err_code);
 }
 
 /**@brief Function for initializing the Connection Parameters module. */
 static void conn_params_init(void)
 {
     ret_code_t             err_code;
     ble_conn_params_init_t cp_init;
 
     memset(&cp_init, 0, sizeof(cp_init));
 
     cp_init.p_conn_params                  = NULL;
     cp_init.first_conn_params_update_delay = FIRST_CONN_PARAMS_UPDATE_DELAY;
     cp_init.next_conn_params_update_delay  = NEXT_CONN_PARAMS_UPDATE_DELAY;
     cp_init.max_conn_params_update_count   = MAX_CONN_PARAMS_UPDATE_COUNT;
     cp_init.start_on_notify_cccd_handle    = BLE_GATT_HANDLE_INVALID;
     cp_init.disconnect_on_fail             = false;
     cp_init.evt_handler                    = NULL;
     cp_init.error_handler                  = NULL;
 
     err_code = ble_conn_params_init(&cp_init);
     APP_ERROR_CHECK(err_code);
 }
 
 /**@brief Function for initializing the NFC module. */
 static void nfc_init(void)
 {
     ret_code_t err_code;
 
     /* Initialize the NFC Tag interface module */
     err_code = nfc_t4t_setup(nfc_callback, NULL);
     APP_ERROR_CHECK(err_code);
 
     /* Create an empty NDEF message to be written to the tag */
     uint8_t language[] = {'e', 'n'};
     uint8_t text[] = "RentScan NFC Tag - Tap to rent";
     uint32_t payload_size = sizeof(text) + 1 + sizeof(language);
     uint8_t payload[payload_size];
 
     // Construct NDEF text record
     err_code = nfc_ndef_record_init(&m_ndef_record, TNF_WELL_KNOWN, NFC_RECORD_TYPE_TEXT, strlen("T"), (uint8_t*)"T", payload_size, payload);
     APP_ERROR_CHECK(err_code);
 
     // Create NDEF message
     uint32_t ndef_msg_len = sizeof(m_ndef_msg_buf);
     err_code = nfc_ndef_msg_encode(&m_ndef_record, m_ndef_msg_buf, &ndef_msg_len);
     APP_ERROR_CHECK(err_code);
 
     // Set created message as the NFC payload
     err_code = nfc_t4t_ndef_file_set(m_ndef_msg_buf, ndef_msg_len);
     APP_ERROR_CHECK(err_code);
 
     // Start sensing NFC field
     err_code = nfc_t4t_emulation_start();
     APP_ERROR_CHECK(err_code);
 
     NRF_LOG_INFO("NFC Tag emulation started.");
 }
 
 /**@brief Function for handling NFC events. */
 static void nfc_callback(void * p_context, nfc_t4t_event_t event, const uint8_t * p_data, size_t data_length)
 {
     ret_code_t err_code;
 
     switch (event)
     {
         case NFC_T4T_EVENT_FIELD_ON:
             NRF_LOG_INFO("NFC field detected.");
             m_nfc_field_active = true;
             
             // Turn on LED to indicate NFC field
             bsp_board_led_on(BSP_BOARD_LED_0);
             
             // Attempt to read tag ID
             nfc_handler_read_tag();
             break;
 
         case NFC_T4T_EVENT_FIELD_OFF:
             NRF_LOG_INFO("NFC field lost.");
             m_nfc_field_active = false;
             
             // Turn off LED
             bsp_board_led_off(BSP_BOARD_LED_0);
             break;
 
         case NFC_T4T_EVENT_NDEF_READ:
             NRF_LOG_INFO("NDEF message read.");
             break;
 
         case NFC_T4T_EVENT_NDEF_UPDATED:
             NRF_LOG_INFO("NDEF message updated.");
             
             // Process the updated NDEF message (could contain rental commands)
             if (data_length > 0 && p_data != NULL)
             {
                 // Parse NDEF message and check if it contains rental information
                 rental_item_t parsed_item;
                 if (nfc_handler_parse_rental_data(p_data, data_length, &parsed_item))
                 {
                     // Process rental operation
                     rental_operation_type_t op_type = rental_data_determine_operation(&parsed_item);
                     switch (op_type)
                     {
                         case RENTAL_OP_CHECKOUT:
                             NRF_LOG_INFO("Rental checkout operation detected.");
                             rental_data_process_checkout(&parsed_item);
                             m_current_item = parsed_item;
                             
                             // Notify BLE if connected
                             if (m_conn_handle != BLE_CONN_HANDLE_INVALID)
                             {
                                 ble_rental_service_item_update(&m_rental_service, &parsed_item);
                             }
                             break;
                             
                         case RENTAL_OP_CHECKIN:
                             NRF_LOG_INFO("Rental checkin operation detected.");
                             rental_data_process_checkin(&parsed_item);
                             m_current_item = parsed_item;
                             
                             // Notify BLE if connected
                             if (m_conn_handle != BLE_CONN_HANDLE_INVALID)
                             {
                                 ble_rental_service_item_update(&m_rental_service, &parsed_item);
                             }
                             break;
                             
                         case RENTAL_OP_STATUS:
                             NRF_LOG_INFO("Rental status check operation detected.");
                             rental_data_get_status(&parsed_item);
                             m_current_item = parsed_item;
                             break;
                             
                         default:
                             NRF_LOG_INFO("Unknown rental operation.");
                             break;
                     }
                     
                     // Update tag content to reflect current status
                     nfc_handler_update_tag_content(&m_current_item);
                 }
             }
             break;
 
         default:
             break;
     }
 }
 
 /**@brief Function for handling NFC scan timer timeout. */
 static void scan_timer_handler(void * p_context)
 {
     // If no NFC field is active, we can actively scan for tags
     if (!m_nfc_field_active)
     {
         // Scan for NFC tags (this would be implemented in nfc_handler.c)
         bool tag_found = nfc_handler_scan_for_tag(&m_current_item);
         
         if (tag_found)
         {
             NRF_LOG_INFO("NFC tag found during scan.");
             
             // Process the tag data and send over BLE if connected
             if (m_conn_handle != BLE_CONN_HANDLE_INVALID)
             {
                 ble_rental_service_item_update(&m_rental_service, &m_current_item);
             }
             
             // Turn on LED to indicate tag found
             bsp_board_led_on(BSP_BOARD_LED_1);
         }
         else
         {
             // Turn off LED if no tag found
             bsp_board_led_off(BSP_BOARD_LED_1);
         }
     }
 }
 
 /**@brief Function for handling rental service write events. */
 static void on_rental_write(uint16_t conn_handle, ble_rental_service_t * p_rental_service, const rental_item_t * p_item)
 {
     NRF_LOG_INFO("Rental data received over BLE.");
     
     // Process the rental data
     m_current_item = *p_item;
     
     // Determine operation and process
     rental_operation_type_t op_type = rental_data_determine_operation(&m_current_item);
     switch (op_type)
     {
         case RENTAL_OP_CHECKOUT:
             NRF_LOG_INFO("Rental checkout operation from BLE.");
             rental_data_process_checkout(&m_current_item);
             break;
             
         case RENTAL_OP_CHECKIN:
             NRF_LOG_INFO("Rental checkin operation from BLE.");
             rental_data_process_checkin(&m_current_item);
             break;
             
         case RENTAL_OP_STATUS:
             NRF_LOG_INFO("Rental status check from BLE.");
             rental_data_get_status(&m_current_item);
             break;
             
         default:
             NRF_LOG_INFO("Unknown rental operation from BLE.");
             break;
     }
     
     // Update tag content if NFC field is active
     if (m_nfc_field_active)
     {
         nfc_handler_update_tag_content(&m_current_item);
     }
     
     // Save to storage
     storage_manager_save_rental_item(&m_current_item);
 }
 
 /**@brief Function for handling rental service events. */
 static void on_rental_evt(ble_rental_evt_t * p_evt)
 {
     switch (p_evt->evt_type)
     {
         case BLE_RENTAL_EVT_NOTIFICATION_ENABLED:
             NRF_LOG_INFO("Rental notifications enabled.");
             break;
             
         case BLE_RENTAL_EVT_NOTIFICATION_DISABLED:
             NRF_LOG_INFO("Rental notifications disabled.");
             break;
             
         default:
             // No implementation needed
             break;
     }
 }
 
 /**@brief Function for application main entry.
  */
 int main(void)
 {
     // Initialize modules
     log_init();
     timer_init();
     buttons_init();
     bsp_board_init(BSP_INIT_LEDS);
     power_management_init();
     ble_stack_init();
     gap_params_init();
     gatt_init();
     services_init();
     conn_params_init();
     
     // Initialize NFC
     nfc_init();
     
     // Initialize storage for rental items
     storage_manager_init();
     
     // Start execution
     // advertising_start(); // Old SDK, comment out
     
     // Start timer for NFC scanning
     app_timer_start(m_scan_timer_id, NFC_SCAN_INTERVAL, NULL);
     
     NRF_LOG_INFO("RentScan system initialization complete.");
     
     // Enter main loop
     for (;;)
     {
         // Process pending logs
         if (NRF_LOG_PROCESS() == false)
         {
             // No logs to process, so wait for an event
             nrf_pwr_mgmt_run();
         }
     }
 }
```

## include/nfc_handler.h
```c
/**
 * @file nfc_handler.h
 * @brief NFC tag handling declarations for RentScan system
 */

 #ifndef NFC_HANDLER_H__
 #define NFC_HANDLER_H__
 
 #include <stdint.h>
 #include <stdbool.h>
 #include "app_error.h"
 #include "rental_data.h"
 
 // Maximum buffer size for NDEF messages
 #define NFC_HANDLER_NDEF_BUFFER_SIZE  256
 
 /**
  * @brief Initialize the NFC handler
  * 
  * @return NRF_SUCCESS if successful, error code otherwise
  */
 ret_code_t nfc_handler_init(void);
 
 /**
  * @brief Read current NFC tag
  * 
  * @return true if a tag was read, false otherwise
  */
 bool nfc_handler_read_tag(void);
 
 /**
  * @brief Scan for NFC tags in the vicinity
  * 
  * @param[out] p_item If a tag is found, this will be populated with the item data
  * @return true if a tag was found, false otherwise
  */
 bool nfc_handler_scan_for_tag(rental_item_t * p_item);
 
 /**
  * @brief Parse rental data from NFC tag content
  * 
  * @param[in] p_data Raw data from NFC tag
  * @param[in] data_length Length of data
  * @param[out] p_item Rental item structure to populate
  * @return true if parsing was successful, false otherwise
  */
 bool nfc_handler_parse_rental_data(const uint8_t * p_data, size_t data_length, rental_item_t * p_item);
 
 /**
  * @brief Update NFC tag content with rental item data
  * 
  * @param[in] p_item Rental item to write to the tag
  * @return true if update was successful, false otherwise
  */
 bool nfc_handler_update_tag_content(const rental_item_t * p_item);
 
 /**
  * @brief Write rental data to an NFC tag
  * 
  * @param[in] p_item Rental item to write
  * @return true if write was successful, false otherwise
  */
 bool nfc_handler_write_tag(const rental_item_t * p_item);
 
 /**
  * @brief Get the current tag ID
  * 
  * @param[out] p_tag_id Buffer to receive tag ID
  * @param[in,out] p_tag_id_length In: Buffer size, Out: Actual tag ID length
  * @return true if tag ID was retrieved, false otherwise
  */
 bool nfc_handler_get_tag_id(uint8_t * p_tag_id, uint8_t * p_tag_id_length);
 
 #endif // NFC_HANDLER_H__
```

## include/rental_data.h
```c
/**
 * @file rental_data.h
 * @brief Definitions and declarations for rental data operations
 */

 #ifndef RENTAL_DATA_H__
 #define RENTAL_DATA_H__
 
 #include <stdint.h>
 #include <stdbool.h>
 #include "app_error.h"
 
 // Maximum length of tag IDs
 #define NFC_TAG_ID_MAX_LENGTH   16
 #define ITEM_NAME_MAX_LENGTH    32
 
 /**
  * @brief Rental item status values
  */
 typedef enum {
     RENTAL_STATUS_AVAILABLE = 0,   /**< Item is available for rental */
     RENTAL_STATUS_RENTED,          /**< Item is currently rented out */
     RENTAL_STATUS_MAINTENANCE,     /**< Item is under maintenance */
     RENTAL_STATUS_LOST             /**< Item is lost or missing */
 } rental_status_t;
 
 /**
  * @brief Rental operation types
  */
 typedef enum {
     RENTAL_OP_UNKNOWN = 0,         /**< Unknown operation */
     RENTAL_OP_CHECKOUT,            /**< Checkout operation */
     RENTAL_OP_CHECKIN,             /**< Checkin operation */
     RENTAL_OP_STATUS               /**< Status query operation */
 } rental_operation_type_t;
 
 /**
  * @brief Rental item structure
  */
 typedef struct {
     uint32_t item_id;                              /**< Unique item identifier */
     char item_name[ITEM_NAME_MAX_LENGTH];          /**< Name/description of the item */
     rental_status_t status;                        /**< Current rental status */
     uint16_t rental_duration;                      /**< Rental duration in hours */
     uint32_t timestamp;                            /**< Timestamp of checkout (0 if not rented) */
     uint8_t tag_id[NFC_TAG_ID_MAX_LENGTH];         /**< NFC tag ID */
     uint8_t tag_id_length;                         /**< Length of the tag ID */
     uint8_t reserved[3];                           /**< Reserved for alignment */
 } rental_item_t;
 
 /**
  * @brief Initialize the rental data module
  *
  * @return NRF_SUCCESS if successful, error code otherwise
  */
 ret_code_t rental_data_init(void);
 
 /**
  * @brief Update the current system time
  * 
  * @param timestamp New timestamp (seconds since epoch)
  */
 void rental_data_update_time(uint32_t timestamp);
 
 /**
  * @brief Get the current system time
  * 
  * @return Current timestamp (seconds since epoch)
  */
 uint32_t rental_data_get_time(void);
 
 /**
  * @brief Determine the type of rental operation
  * 
  * @param[in] p_item Rental item to analyze
  * @return Type of rental operation
  */
 rental_operation_type_t rental_data_determine_operation(const rental_item_t * p_item);
 
 /**
  * @brief Process a rental checkout operation
  * 
  * @param[in,out] p_item Rental item to process (will be updated with current data)
  * @return true if checkout was successful, false otherwise
  */
 bool rental_data_process_checkout(rental_item_t * p_item);
 
 /**
  * @brief Process a rental checkin operation
  * 
  * @param[in,out] p_item Rental item to process (will be updated with current data)
  * @return true if checkin was successful, false otherwise
  */
 bool rental_data_process_checkin(rental_item_t * p_item);
 
 /**
  * @brief Get the status of a rental item
  * 
  * @param[in,out] p_item Rental item to query (will be updated with current data)
  * @return true if status retrieved successfully, false otherwise
  */
 bool rental_data_get_status(rental_item_t * p_item);
 
 /**
  * @brief Add a new rental item to the database
  * 
  * @param[in] p_item New rental item to add
  * @return true if item was added successfully, false otherwise
  */
 bool rental_data_add_item(const rental_item_t * p_item);
 
 /**
  * @brief Remove a rental item from the database
  * 
  * @param[in] item_id ID of item to remove
  * @return true if item was removed successfully, false otherwise
  */
 bool rental_data_remove_item(uint32_t item_id);
 
 /**
  * @brief Check for overdue rental items
  * 
  * @param[out] p_items Array to receive overdue items
  * @param[in] max_items Maximum number of items the array can hold
  * @param[out] p_num_items Number of overdue items found
  * @return true if operation was successful, false otherwise
  */
 bool rental_data_check_overdue(rental_item_t * p_items, uint8_t max_items, uint8_t * p_num_items);
 
 #endif // RENTAL_DATA_H__
```

## include/rental_service.h
```c
/**
 * @file rental_service.h
 * @brief BLE Rental Service declarations
 */

 #ifndef RENTAL_SERVICE_H__
 #define RENTAL_SERVICE_H__
 
 #include <stdint.h>
 #include <stdbool.h>
 #include "ble.h"
 #include "ble_srv_common.h"
 #include "rental_data.h"
 
 /**
  * @brief Rental service event types
  */
 typedef enum
 {
     BLE_RENTAL_EVT_NOTIFICATION_ENABLED,  /**< Rental value notification enabled */
     BLE_RENTAL_EVT_NOTIFICATION_DISABLED, /**< Rental value notification disabled */
 } ble_rental_evt_type_t;
 
 /**
  * @brief Rental service event
  */
 typedef struct
 {
     ble_rental_evt_type_t evt_type;       /**< Type of event */
 } ble_rental_evt_t;
 
 // Forward declaration of the ble_rental_service_t type
 typedef struct ble_rental_service_s ble_rental_service_t;
 
 /**
  * @brief Rental Service event handler type
  */
 typedef void (*ble_rental_evt_handler_t) (ble_rental_evt_t * p_evt);
 
 /**
  * @brief Rental Service write handler type
  */
 typedef void (*ble_rental_write_handler_t) (uint16_t conn_handle, ble_rental_service_t * p_rental_service, const rental_item_t * p_item);
 
 /**
  * @brief Rental Service initialization structure
  */
 typedef struct
 {
     ble_rental_evt_handler_t evt_handler;    /**< Event handler to be called for handling events in the Rental Service */
     ble_rental_write_handler_t write_handler; /**< Write handler to be called when rental data is received */
 } ble_rental_service_init_t;
 
 /**
  * @brief Rental Service structure
  */
 struct ble_rental_service_s
 {
     uint16_t service_handle;                   /**< Handle of Rental Service (as provided by the BLE stack). */
     ble_gatts_char_handles_t rental_item_char_handles; /**< Handles related to the Rental Item characteristic. */
     uint8_t uuid_type;                         /**< UUID type for the Rental Service. */
     uint16_t conn_handle;                      /**< Handle of the current connection (BLE_CONN_HANDLE_INVALID if not in a connection). */
     ble_rental_evt_handler_t evt_handler;      /**< Event handler to be called for handling events in the Rental Service. */
     ble_rental_write_handler_t write_handler;  /**< Write handler to be called when rental data is received. */
 };
 
 /**
  * @brief Macro for defining a ble_rental_service instance
  */
 #define BLE_RENTAL_SERVICE_DEF(_name)                                                \
 static ble_rental_service_t _name;                                                   \
 NRF_SDH_BLE_OBSERVER(_name ## _obs,                                                  \
                      BLE_HRS_BLE_OBSERVER_PRIO,                                      \
                      NULL, NULL)
 
 /**
  * @brief Function for initializing the Rental Service
  *
  * @param[out] p_rental_service  Rental Service structure
  * @param[in]  p_rental_service_init  Information needed to initialize the service
  *
  * @return     NRF_SUCCESS on success, otherwise an error code
  */
 uint32_t ble_rental_service_init(ble_rental_service_t * p_rental_service, const ble_rental_service_init_t * p_rental_service_init);
 
 /**
  * @brief Function for sending rental item data
  *
  * @param[in] p_rental_service  Rental Service structure
  * @param[in] p_item            Rental item structure
  *
  * @return    NRF_SUCCESS on success, otherwise an error code
  */
 uint32_t ble_rental_service_item_update(ble_rental_service_t * p_rental_service, const rental_item_t * p_item);
 
 #endif // RENTAL_SERVICE_H__
```

## include/storage_manager.h
```c
/**
 * @file storage_manager.h
 * @brief Declarations for persistent storage operations
 */

 #ifndef STORAGE_MANAGER_H__
 #define STORAGE_MANAGER_H__
 
 #include <stdint.h>
 #include "app_error.h"
 #include "rental_data.h"
 
 /**
  * @brief Initialize the storage manager
  * 
  * @return NRF_SUCCESS if initialization was successful, error code otherwise
  */
 ret_code_t storage_manager_init(void);
 
 /**
  * @brief Save rental items to flash storage
  * 
  * @param[in] p_items Array of rental items to save
  * @param[in] num_items Number of items in the array
  * @return NRF_SUCCESS if saved successfully, error code otherwise
  */
 ret_code_t storage_manager_save_items(const rental_item_t * p_items, uint8_t num_items);
 
 /**
  * @brief Save a single rental item to flash storage
  * 
  * This updates the item in flash if it exists, or adds it if it doesn't.
  * 
  * @param[in] p_item Rental item to save
  * @return NRF_SUCCESS if saved successfully, error code otherwise
  */
 ret_code_t storage_manager_save_rental_item(const rental_item_t * p_item);
 
 /**
  * @brief Remove a rental item from flash storage
  * 
  * @param[in] item_id ID of the item to remove
  * @return NRF_SUCCESS if removed successfully, error code otherwise
  */
 ret_code_t storage_manager_remove_rental_item(uint32_t item_id);
 
 /**
  * @brief Load rental items from flash storage
  * 
  * @param[out] p_items Array to receive the rental items
  * @param[in] max_items Maximum number of items the array can hold
  * @param[out] p_num_items Number of items loaded
  * @return NRF_SUCCESS if loaded successfully, error code otherwise
  */
 ret_code_t storage_manager_load_rental_items(rental_item_t * p_items, uint8_t max_items, uint8_t * p_num_items);
 
 #endif // STORAGE_MANAGER_H__
```

## src/nfc_handler.c
```c
/**
 * @file nfc_handler.c
 * @brief NFC tag handling functionality for RentScan system
 * 
 * This file contains functions for handling NFC tag reading, writing,
 * and data parsing for the RentScan rental system.
 */

 #include <string.h>
 #include <stdlib.h>  // For rand()
 #include <stdio.h>   // For snprintf
 #include "nfc_handler.h"
 #include "nrf_log.h"
 #include "app_error.h"
 #include "nfc_t4t_lib.h"
 #include "nfc_ndef_msg.h"
 #include "nfc_ndef_record.h"
 #include "nfc_ndef_text_rec.h"
 
 // Buffer for NDEF message
 static uint8_t m_ndef_buffer[NFC_HANDLER_NDEF_BUFFER_SIZE];
 // static uint32_t m_ndef_buffer_len; // Unused
 
 // Current tag ID
 static uint8_t m_current_tag_id[NFC_TAG_ID_MAX_LENGTH];
 static uint8_t m_current_tag_id_length = 0;
 
 /**
  * @brief Initialize the NFC handler
  * 
  * @return NRF_SUCCESS if successful, error code otherwise
  */
 ret_code_t nfc_handler_init(void)
 {
     // Initialize buffers
     memset(m_ndef_buffer, 0, NFC_HANDLER_NDEF_BUFFER_SIZE);
     memset(m_current_tag_id, 0, NFC_TAG_ID_MAX_LENGTH);
     m_current_tag_id_length = 0;
     
     return NRF_SUCCESS;
 }
 
 /**
  * @brief Read current NFC tag
  * 
  * @return true if a tag was read, false otherwise
  */
 bool nfc_handler_read_tag(void)
 {
     bool tag_read = false;
     
     // This would normally be implemented with specific code for the NFC reader
     // Since nRF52840 doesn't have a direct NFC reader, this would likely involve:
     // 1. Using an external NFC reader connected via SPI/I2C
     // 2. Communicating with the reader to get tag data
     
     // For this example, we'll simulate tag reading with dummy data
     // In a real implementation, this would read from the actual NFC hardware
     
     // Simulate successful tag reading
     uint8_t dummy_tag_id[] = {0x04, 0xEB, 0x71, 0x3A, 0x4C, 0x84, 0x80};
     m_current_tag_id_length = sizeof(dummy_tag_id);
     memcpy(m_current_tag_id, dummy_tag_id, m_current_tag_id_length);
     
     NRF_LOG_INFO("NFC tag read: ID length %d", m_current_tag_id_length);
     NRF_LOG_HEXDUMP_INFO(m_current_tag_id, m_current_tag_id_length);
     
     tag_read = true;
     
     return tag_read;
 }
 
 /**
  * @brief Scan for NFC tags in the vicinity
  * 
  * @param[out] p_item If a tag is found, this will be populated with the item data
  * @return true if a tag was found, false otherwise
  */
 bool nfc_handler_scan_for_tag(rental_item_t * p_item)
 {
     bool tag_found = false;
     
     // This would normally scan for NFC tags within range
     // Since the nRF52840 doesn't have tag scanning capability directly,
     // this would typically involve an external NFC reader module
     
     // For this example, we'll simulate tag finding with dummy data
     // In a real implementation, this would scan using actual NFC hardware
     
     // 1 in 5 chance of "finding" a tag during scan for demonstration purposes
     if (rand() % 5 == 0)
     {
         // Simulate a found tag
         uint8_t dummy_tag_id[] = {0x04, 0xDA, 0x43, 0x2B, 0x65, 0x92, 0xF0};
         m_current_tag_id_length = sizeof(dummy_tag_id);
         memcpy(m_current_tag_id, dummy_tag_id, m_current_tag_id_length);
         
         // Create a dummy rental item
         if (p_item != NULL)
         {
             memset(p_item, 0, sizeof(rental_item_t));
             memcpy(p_item->tag_id, m_current_tag_id, m_current_tag_id_length);
             p_item->tag_id_length = m_current_tag_id_length;
             
             // Set some dummy data
             p_item->item_id = 12345;
             strncpy(p_item->item_name, "Demo Item", sizeof(p_item->item_name) - 1);
             p_item->status = RENTAL_STATUS_AVAILABLE;
             p_item->rental_duration = 24; // 24 hours
             p_item->timestamp = 0; // No active rental
         }
         
         NRF_LOG_INFO("NFC tag found during scan: ID length %d", m_current_tag_id_length);
         NRF_LOG_HEXDUMP_INFO(m_current_tag_id, m_current_tag_id_length);
         
         tag_found = true;
     }
     
     return tag_found;
 }
 
 /**
  * @brief Parse rental data from NFC tag content
  * 
  * @param[in] p_data Raw data from NFC tag
  * @param[in] data_length Length of data
  * @param[out] p_item Rental item structure to populate
  * @return true if parsing was successful, false otherwise
  */
 bool nfc_handler_parse_rental_data(const uint8_t * p_data, size_t data_length, rental_item_t * p_item)
 {
     if (p_data == NULL || p_item == NULL || data_length == 0)
     {
         return false;
     }
     
     // This function would parse an NDEF message from the NFC tag
     // and extract rental information from it
     
     // In a real implementation, this would parse NDEF records
     // For this example, we'll use a simplified format
     
     // Check if the data is large enough to be valid
     if (data_length < sizeof(rental_item_t))
     {
         NRF_LOG_WARNING("Data too short to be a valid rental item");
         return false;
     }
     
     // Simple case: assume the data is a directly encoded rental_item_t
     // In a real implementation, this would involve proper NDEF parsing
     memcpy(p_item, p_data, sizeof(rental_item_t));
     
     // Validate the parsed data
     if (p_item->tag_id_length > NFC_TAG_ID_MAX_LENGTH)
     {
         NRF_LOG_WARNING("Invalid tag ID length in parsed data");
         return false;
     }
     
     NRF_LOG_INFO("Parsed rental data: Item ID %d, Status %d", p_item->item_id, p_item->status);
     
     return true;
 }
 
 /**
  * @brief Update NFC tag content with rental item data
  * 
  * @param[in] p_item Rental item to write to the tag
  * @return true if update was successful, false otherwise
  */
 bool nfc_handler_update_tag_content(const rental_item_t * p_item)
 {
     ret_code_t err_code;
     
     if (p_item == NULL)
     {
         return false;
     }
     
     // Create an NDEF message with rental information
     // This would normally be a more complex NDEF message creation
     // For simplicity, we'll use a text record with some basic info
     
     // Create a text description of the rental status
     char status_text[128];
     const char* status_str = ""; // Initialize to empty string
     
     switch (p_item->status)
     {
         case RENTAL_STATUS_AVAILABLE:
             status_str = "Available";
             break;
         case RENTAL_STATUS_RENTED:
             status_str = "Rented";
             break;
         case RENTAL_STATUS_MAINTENANCE:
             status_str = "Maintenance";
             break;
         case RENTAL_STATUS_LOST:
             status_str = "Lost";
             break;
         default:
             status_str = "Unknown";
             break;
     }
     
     // Format a status message
     snprintf(status_text, sizeof(status_text), 
              "Item: %s\nID: %d\nStatus: %s\nDuration: %d hours",
              p_item->item_name, p_item->item_id, status_str, p_item->rental_duration);
     
     // Create NDEF text record
     uint8_t language[] = "en"; // English language code
     
     // Use nfc_ndef_text_record_create from compatibility layer
     err_code = nfc_ndef_text_record_create((uint8_t*)language, sizeof(language) -1, // Exclude null terminator
                                         (uint8_t*)status_text, strlen(status_text),
                                         NULL); // No specific record descriptor needed here
     if (err_code != NRF_SUCCESS)
     {
         NRF_LOG_ERROR("Failed to create NDEF text record: %d", err_code);
         return false;
     }
     
     // Write the NDEF message to the tag (simulated)
     err_code = NRF_SUCCESS; // Placeholder, actual write needed
     if (err_code != NRF_SUCCESS)
     {
         NRF_LOG_ERROR("Failed to set NDEF file: %d", err_code);
         return false;
     }
     
     NRF_LOG_INFO("NFC tag content updated with rental information");
     return true;
 }
 
 /**
  * @brief Write rental data to an NFC tag
  * 
  * @param[in] p_item Rental item to write
  * @return true if write was successful, false otherwise
  */
 bool nfc_handler_write_tag(const rental_item_t * p_item)
 {
     if (p_item == NULL)
     {
         return false;
     }
     
     // This would normally handle the process of writing to a physical NFC tag
     // Since we're using tag emulation in this example, we'll just use the update function
     
     return nfc_handler_update_tag_content(p_item);
 }
 
 /**
  * @brief Get the current tag ID
  * 
  * @param[out] p_tag_id Buffer to receive tag ID
  * @param[in,out] p_tag_id_length In: Buffer size, Out: Actual tag ID length
  * @return true if tag ID was retrieved, false otherwise
  */
 bool nfc_handler_get_tag_id(uint8_t * p_tag_id, uint8_t * p_tag_id_length)
 {
     if (p_tag_id == NULL || p_tag_id_length == NULL || *p_tag_id_length < m_current_tag_id_length)
     {
         return false;
     }
     
     // Copy the current tag ID
     memcpy(p_tag_id, m_current_tag_id, m_current_tag_id_length);
     *p_tag_id_length = m_current_tag_id_length;
     
     return (m_current_tag_id_length > 0);
 }
```
