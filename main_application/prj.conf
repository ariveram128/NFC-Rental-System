## CMakeLists.txt
```
cmake_minimum_required(VERSION 3.20.0)

# Find Zephyr package
find_package(Zephyr REQUIRED HINTS $ENV{ZEPHYR_BASE})
project(rent_scan)

# Application sources
target_sources(app PRIVATE
    src/main.c
    src/nfc_handler.c
    src/ble_handler.c
    src/rental_logic.c
)

# Include directories
target_include_directories(app PRIVATE include)
```

## prj.conf
```kconfig
#
# Copyright (c) 2023 Nordic Semiconductor ASA
#
# SPDX-License-Identifier: Apache-2.0
#

# Logger configuration
CONFIG_LOG=y
CONFIG_LOG_DEFAULT_LEVEL=3
CONFIG_LOG_BACKEND_UART=y

# NFC configuration
CONFIG_NFC_T2T_NRFXLIB=y
CONFIG_NFC_NDEF=y
CONFIG_NFC_NDEF_RECORD=y
CONFIG_NFC_NDEF_MSG=y
CONFIG_NFC_NDEF_PARSER=y
CONFIG_NFC_NDEF_TEXT_RECORD=y
CONFIG_NFC_T2T_PARSER=y
CONFIG_NFC_NDEF_URI_MSG=y
CONFIG_NFC_NDEF_URI_REC=y
CONFIG_NRFX_NFCT=y
CONFIG_NRFX_TIMER4=y
CONFIG_NFCT_IRQ_PRIORITY=5
CONFIG_NFCT_PINS_AS_GPIOS=n
CONFIG_GPIO=y

# For Zephry general
CONFIG_POLL=y
CONFIG_ASSERT=y
CONFIG_REBOOT=y
CONFIG_MAIN_STACK_SIZE=2048
CONFIG_SYSTEM_WORKQUEUE_STACK_SIZE=1024
CONFIG_HEAP_MEM_POOL_SIZE=4096

# Bluetooth Core
CONFIG_BT=y
CONFIG_BT_PERIPHERAL=y
CONFIG_BT_DEVICE_NAME="RentScan"
CONFIG_BT_DEVICE_APPEARANCE=0

# Disable PHY update requests to address connection issues
CONFIG_BT_PHY_UPDATE=n
CONFIG_BT_AUTO_PHY_UPDATE=n

# BLE GAP
CONFIG_BT_BROADCASTER=y
CONFIG_BT_OBSERVER=y

# BLE GATT
CONFIG_BT_GATT_DYNAMIC_DB=y
CONFIG_BT_NUS=y

# BLE Settings
CONFIG_SETTINGS=y

# MTU 
CONFIG_BT_L2CAP_TX_MTU=247
CONFIG_BT_BUF_ACL_RX_SIZE=251
CONFIG_BT_BUF_ACL_TX_SIZE=251

# BLE Security settings - simplify for better compatibility
CONFIG_BT_SMP=y
CONFIG_BT_SMP_SC_ONLY=n
CONFIG_BT_TINYCRYPT_ECC=y
CONFIG_BT_SMP_ALLOW_UNAUTH_OVERWRITE=y

# UART for debugging 
CONFIG_SERIAL=y
```

## src/main.c
```c
/* main.c - RentScan NFC Tag Reader Application */

/*
 * Copyright (c) 2019 Nordic Semiconductor ASA
 * Copyright (c) 2025 RentScan Project Team
 *
 * SPDX-License-Identifier: LicenseRef-Nordic-5-Clause
 */
#include <zephyr/kernel.h>
#include <zephyr/logging/log.h>
#include <zephyr/bluetooth/bluetooth.h>
#include <zephyr/settings/settings.h>

#include "ble_handler.h"
#include "nfc_handler.h"

LOG_MODULE_REGISTER(main, LOG_LEVEL_INF);

/* Simple status check function to send periodic BLE messages */
void status_loop(void)
{
    int counter = 0;
    while (1) {
        char msg[32];
        snprintf(msg, sizeof(msg), "STATUS UPDATE: %d", counter++);
        ble_send(msg);
        k_sleep(K_SECONDS(10));  // Check every 10 seconds
    }
}

int main(void)
{
    int err;

    LOG_INF("=== RentScan Application Booting ===");

    /* Enable Bluetooth */
    err = bt_enable(NULL);
    if (err) {
        LOG_ERR("Bluetooth initialization failed (err %d)", err);
        return 0;
    }
    LOG_INF("Bluetooth initialized");

    /* Load saved BLE settings if enabled */
    if (IS_ENABLED(CONFIG_SETTINGS)) {
        settings_load();
    }

    /* Initialize BLE advertising + NUS service */
    err = ble_handler_init();
    if (err) {
        LOG_ERR("BLE handler initialization failed (err %d)", err);
        return 0;
    }
    
    /* Initialize NFC reader */
    err = nfc_reader_init();
    if (err) {
        LOG_ERR("NFC reader initialization failed (err %d)", err);
        return 0;
    }

    LOG_INF("RentScan initialized and ready for NFC tags");

    /* Start periodic status updates via BLE */
    status_loop();

    return 0;
}
```

## include/ble_handler.h
```c
/*
 * Copyright (c) 2023 Nordic Semiconductor ASA
 *
 * SPDX-License-Identifier: Apache-2.0
 */

#ifndef BLE_HANDLER_H
#define BLE_HANDLER_H

/**
 * @brief Initialize the BLE subsystem
 *
 * @return 0 on success, negative error code otherwise
 */
int ble_handler_init(void);

/**
 * @brief Send rental data over BLE
 *
 * @param tag_id The identifier of the NFC tag
 * @param timestamp The timestamp when the rental was initiated
 * @return 0 on success, negative error code otherwise
 */
int ble_send_rental_data(const char *tag_id, uint32_t timestamp);


/**
 * @brief Send a message over BLE UART service
 *
 * @param msg The message to send
 * @return 0 on success, negative errno otherwise
 */
int ble_send(const char *msg);


#endif /* BLE_HANDLER_H */
```

## include/nfc_handler.h
```c
/* 
 * Copyright (c) 2023 Nordic Semiconductor ASA
 *
 * SPDX-License-Identifier: Apache-2.0
 */

 #ifndef NFC_HANDLER_H
 #define NFC_HANDLER_H
 #define MAX_ITEM_ID_LEN 64
 
 #include <zephyr/kernel.h>
 #include <stddef.h>
 #include <stdint.h>
 
 /**
  * @brief Initialize the NFC reader
  *
  * This function initializes the NFC reader functionality for tag polling.
  *
  * @return 0 on success, otherwise a negative error code
  */
 int nfc_reader_init(void);
 
 /**
  * @brief Initialize the NFC subsystem
  *
  * This function initializes the NFC Type 4 Tag emulation and
  * prepares for tag reading.
  *
  * @return 0 on success, otherwise a negative error code
  */
 int nfc_init(void);
 
 /**
  * @brief Start NFC field polling
  *
  * This function starts the polling for NFC tags.
  *
  * @return 0 on success, otherwise a negative error code
  */
 int nfc_start_polling(void);
 
 /**
  * @brief Stop NFC field polling
  *
  * This function stops the polling for NFC tags.
  *
  * @return 0 on success, otherwise a negative error code
  */
 int nfc_stop_polling(void);
 
 /**
  * @brief Callback function when an NFC tag is detected
  *
  * This function handles an NFC tag when detected, reading and parsing
  * the NDEF message to extract the Item ID.
  *
  * @param item_id Buffer to store the extracted item ID text
  * @param max_len Maximum length of the item_id buffer
  * @return Length of the item ID on success, otherwise a negative error code
  */
 int nfc_handle_tag_detected(char *item_id, size_t max_len);
 

 /**
 * @brief Update the item ID in the NFC tag
 *
 * @param new_id The new item ID to set
 * @param id_len Length of the new item ID
 * @return 0 on success, negative errno otherwise
 */
int nfc_update_item_id(const char *new_id, size_t id_len);



 #endif /* NFC_HANDLER_H */
 
```

## include/rental_logic.h
```c
/* rental_logic.h - RentScan Rental System Logic */

#ifndef RENTAL_LOGICH
#define RENTAL_LOGICH

#include <stddef.h>
#include <stdint.h>

/*
 
@brief Process a scanned NFC tag containing an item ID
This function is called when an NFC tag with item information is read.
It handles the rental business logic, such as starting/ending rentals
or checking item status.
@param[in] item_id Pointer to item identifier data
@param[in] item_id_len Length of the item identifier data 
*/
void rental_logic_process_scan(const uint8_t *item_id, size_t item_id_len);

/*
@brief Periodically checks rental status and sends BLE notifications*
This function should be called in a loop or thread to monitor if
the rental is still active or has expired, and send status updates
over BLE accordingly.*/
void rental_logic_update_status(void);

#endif /* RENTAL_LOGICH */
```

## src/ble_handler.c
```c
/*
 * Copyright (c) 2023 Nordic Semiconductor ASA
 *
 * SPDX-License-Identifier: Apache-2.0
 */
#include <zephyr/kernel.h>
#include <zephyr/logging/log.h>
#include <zephyr/bluetooth/bluetooth.h>
#include <zephyr/bluetooth/conn.h>
#include <bluetooth/services/nus.h>

#include "ble_handler.h"

LOG_MODULE_REGISTER(ble_handler, LOG_LEVEL_INF);

static struct bt_conn *current_conn = NULL;
static volatile bool notifications_enabled = false; // Ensure volatile for ISR context

// Work item for periodic checks and status messages
static struct k_work_delayable status_work;

// Forward declarations
static void status_work_handler(struct k_work *work);
static void print_service_info(void);
static void nus_send_status_cb(enum bt_nus_send_status status); // Add forward declaration for the new callback

static void connected(struct bt_conn *conn, uint8_t err)
{
    if (err) {
        LOG_ERR("Connection failed (err %u)", err);
        return;
    }
    current_conn = bt_conn_ref(conn);
    LOG_INF("Connected");
    
    // Reset notification state on new connection
    notifications_enabled = false; 

    // Start periodic status checks
    k_work_schedule(&status_work, K_MSEC(1000));
}

static void disconnected(struct bt_conn *conn, uint8_t reason)
{
    LOG_INF("Disconnected (reason %u)", reason);
    
    // Cancel periodic status checks
    k_work_cancel_delayable(&status_work);
    
    if (current_conn) {
        bt_conn_unref(current_conn);
        current_conn = NULL;
    }
    notifications_enabled = false;
    LOG_INF("Notifications flag reset."); // Added log
}

BT_CONN_CB_DEFINE(conn_callbacks) = {
    .connected = connected,
    .disconnected = disconnected,
};

static void nus_receive_cb(struct bt_conn *conn, const uint8_t *data, uint16_t len)
{
    char msg[64];
    memcpy(msg, data, MIN(len, sizeof(msg) - 1));
    msg[MIN(len, sizeof(msg) - 1)] = '\0';
    LOG_INF("Received over BLE: %s (len %u)", msg, len);
    
    // If we received data from central, it's a good sign we're connected correctly
    // The central might send data before enabling notifications.
    // We should not assume notifications are enabled just by receiving data.
    // The nus_send_status_cb callback is the definitive source for notification status.
}

// Callback for when NUS sends a notification successfully
static void nus_sent_cb(struct bt_conn *conn)
{
    // This callback confirms that a notification was successfully sent to the peer.
    // It doesn't necessarily mean the peer *processed* it, but the transport layer did its job.
    LOG_INF("NUS data sent successfully to %p", (void *)conn); // Cast conn to void* for logging
    // We don't set notifications_enabled = true here because the CCCD callback is the source of truth.
}

// New callback for NUS send status (reflects CCCD changes)
static void nus_send_status_cb(enum bt_nus_send_status status)
{
    if (status == BT_NUS_SEND_STATUS_ENABLED) {
        LOG_INF("✅ NUS notifications enabled by central");
        notifications_enabled = true;
        
        // Send a welcome message to confirm the notification channel works
        char welcome_msg[60];
        snprintf(welcome_msg, sizeof(welcome_msg), "RentScan ready! Notifications ON. Uptime: %us", k_uptime_get_32() / 1000);
        // Log before sending to help diagnosis
        LOG_INF("Sending welcome notification: '%s'", welcome_msg);
        
        // It's generally safe to call ble_send from this callback as NUS service calls it from a work queue context.
        int err = ble_send(welcome_msg);
        if (err) {
            LOG_ERR("Failed to send welcome message (err %d)", err);
        } else {
            LOG_INF("Welcome notification sent successfully");
        }
    } else if (status == BT_NUS_SEND_STATUS_DISABLED) {
        LOG_INF("❌ NUS notifications disabled by central");
        notifications_enabled = false;
    } else {
        LOG_WRN("NUS send status unknown: %d", status);
    }
}

static struct bt_nus_cb nus_cb = {
    .received = nus_receive_cb,
    .sent = nus_sent_cb,
    .send_enabled = nus_send_status_cb, // Correctly assign to send_enabled
};

// Periodic work handler to check status and try sending test messages
static void status_work_handler(struct k_work *work)
{
    static uint32_t counter = 0;
    counter++;
    
    if (current_conn && !notifications_enabled) {
        LOG_WRN("Connected but notifications not enabled (attempt %u)", counter);
        
        // Don't try to force notifications - the central must enable them
        // by writing to the CCCD (Client Characteristic Configuration Descriptor)
        
        // Just log the warning - don't try to send data
        
        // After a long time without notifications, we could optionally disconnect
        // to allow the central to reconnect with proper notification setup
        if (counter > 60) { // After about a minute
            LOG_WRN("No notifications enabled after %u attempts. Consider re-pairing.", counter);
            // Uncomment to implement disconnect after timeout:
            // bt_conn_disconnect(current_conn, BT_HCI_ERR_REMOTE_USER_TERM_CONN);
        }
    } else if (current_conn && notifications_enabled) {
        // Optionally, send a periodic heartbeat if notifications are enabled
        if (counter % 30 == 0) {
            char heartbeat_msg[30];
            snprintf(heartbeat_msg, sizeof(heartbeat_msg), "Peripheral Heartbeat %u", counter / 30);
            ble_send(heartbeat_msg); // Enable heartbeat to confirm notifications work
        }
    }
    
    // Reschedule the work
    k_work_schedule(&status_work, K_MSEC(1000));  // Check every 1 second
}

int ble_handler_init(void)
{
    int err;
    
    // Initialize the status check work
    k_work_init_delayable(&status_work, status_work_handler);

    LOG_INF("Initializing Nordic UART Service (NUS)");
    err = bt_nus_init(&nus_cb);
    if (err) {
        LOG_ERR("Failed to init NUS (err %d)", err);
        return err;
    }
    
    // Log information about registered services
    print_service_info();

    // BLE advertising data
    static const struct bt_data ad[] = {
        BT_DATA_BYTES(BT_DATA_FLAGS, (BT_LE_AD_GENERAL | BT_LE_AD_NO_BREDR)),
        BT_DATA_BYTES(BT_DATA_UUID128_ALL, BT_UUID_NUS_VAL),
        BT_DATA_BYTES(BT_DATA_NAME_COMPLETE, 'R', 'e', 'n', 't', 'S', 'c', 'a', 'n'),
    };

    // BLE advertising parameters
    struct bt_le_adv_param param = BT_LE_ADV_PARAM_INIT(
        BT_LE_ADV_OPT_CONNECTABLE | BT_LE_ADV_OPT_USE_NAME,
        BT_GAP_ADV_FAST_INT_MIN_2,
        BT_GAP_ADV_FAST_INT_MAX_2,
        NULL);

    // Start advertising
    err = bt_le_adv_start(&param, ad, ARRAY_SIZE(ad), NULL, 0);
    if (err) {
        LOG_ERR("Advertising failed to start (err %d)", err);
        return err;
    }

    LOG_INF("Advertising as RentScan device with NUS service");
    return 0;
}

// Helper function to verify registered services
static void print_service_info(void)
{
    LOG_INF("Registered BLE services and characteristics:");
    LOG_INF("NUS Service UUID: 6E400001-B5A3-F393-E0A9-E50E24DCCA9E");
    LOG_INF("  RX Char UUID:   6E400002-B5A3-F393-E0A9-E50E24DCCA9E (Write)");
    LOG_INF("  TX Char UUID:   6E400003-B5A3-F393-E0A9-E50E24DCCA9E (Notify)");
}

int ble_send(const char *msg)
{
    if (!current_conn) {
        LOG_WRN("No BLE connection, cannot send");
        return -ENOTCONN;
    }
    
    if (!notifications_enabled) {
        LOG_WRN("BLE notifications not enabled by central. Cannot send. Central must subscribe to TX char.");
        return -EPERM; // EPERM (Operation not permitted) is more fitting than EINVAL here
    }

    int err = bt_nus_send(current_conn, msg, strlen(msg));
    if (err) {
        LOG_ERR("Failed to send over NUS (err %d)", err);
        
        // If we get an error while notifications are enabled, they might actually be disabled
        // This case should ideally not happen if CCCD state is managed correctly.
        if (err == -EINVAL || err == -EPIPE) { // EPIPE (Broken pipe) can also occur
            LOG_WRN("NUS send failed (err %d) despite notifications_enabled=true. Resetting flag.", err);
            notifications_enabled = false; // Re-evaluate notification state
        }
    } else {
        LOG_INF("Sent over BLE: %s", msg);
    }

    return err;
}

int ble_send_rental_data(const char *tag_id, uint32_t timestamp)
{
    char msg[64];
    snprintf(msg, sizeof(msg), "[%s] RENTAL START: %u", tag_id, timestamp);
    return ble_send(msg);
}
```

## src/nfc_handler.c
```c
/*
 * Copyright (c) 2023 Nordic Semiconductor ASA
 *
 * SPDX-License-Identifier: Apache-2.0
 */
#include <zephyr/kernel.h>
#include <zephyr/logging/log.h>
#include <nfc_t2t_lib.h>
#include <nfc/ndef/msg.h>
#include <nfc/ndef/text_rec.h>
#include "nfc_handler.h"
#include "ble_handler.h"

LOG_MODULE_REGISTER(nfc_handler, LOG_LEVEL_INF);

#define MAX_NDEF_RECORDS 2
#define NDEF_MSG_BUF_SIZE 256

static uint8_t ndef_msg_buf[NDEF_MSG_BUF_SIZE];
static uint8_t default_item_id[] = "item123";
static const uint8_t en_code[] = "en";

static uint8_t current_item_id[MAX_ITEM_ID_LEN];
static size_t current_item_id_len = 0;

static void nfc_callback(void *context, nfc_t2t_event_t event, const uint8_t *data, size_t data_length)
{
    ARG_UNUSED(context);

    switch (event) {
    case NFC_T2T_EVENT_FIELD_ON:
        LOG_INF("📶 NFC field detected");
        break;

    case NFC_T2T_EVENT_FIELD_OFF:
        LOG_INF("❌ NFC field lost");
        break;

    case NFC_T2T_EVENT_DATA_READ:
        LOG_INF("📲 NFC tag read by phone - sent item ID: %s", current_item_id);
        
        // Send notification over BLE when tag is read
        char msg[64];
        snprintf(msg, sizeof(msg), "TAG_READ: %s", current_item_id);
        ble_send(msg);
        
        // Also send as rental data to demonstrate the function
        ble_send_rental_data((char *)current_item_id, k_uptime_get_32() / 1000);
        break;

    default:
        LOG_WRN("Unhandled NFC event: %d", event);
        break;
    }
}

static int create_item_id_ndef_msg(uint8_t *buffer, uint32_t *len)
{
    int err;

    const uint8_t *item_id_data = (current_item_id_len > 0) ? current_item_id : default_item_id;
    size_t item_id_len = (current_item_id_len > 0) ? current_item_id_len : sizeof(default_item_id) - 1;

    NFC_NDEF_TEXT_RECORD_DESC_DEF(item_id_rec,
                                   UTF_8,
                                   en_code,
                                   sizeof(en_code) - 1,
                                   item_id_data,
                                   item_id_len);

    NFC_NDEF_MSG_DEF(nfc_msg, MAX_NDEF_RECORDS);
    err = nfc_ndef_msg_record_add(&NFC_NDEF_MSG(nfc_msg),
                                   &NFC_NDEF_TEXT_RECORD_DESC(item_id_rec));
    if (err < 0) {
        LOG_ERR("Failed to add record to NDEF msg (err %d)", err);
        return err;
    }

    err = nfc_ndef_msg_encode(&NFC_NDEF_MSG(nfc_msg), buffer, len);
    if (err < 0) {
        LOG_ERR("Failed to encode NDEF msg (err %d)", err);
        return err;
    }

    return 0;
}

int nfc_reader_init(void)
{
    int err;

    LOG_INF("🚀 Initializing NFC tag (emulation mode)");

    memcpy(current_item_id, default_item_id, sizeof(default_item_id) - 1);
    current_item_id_len = sizeof(default_item_id) - 1;

    err = nfc_t2t_setup(nfc_callback, NULL);
    if (err) {
        LOG_ERR("Failed to setup NFC (err %d)", err);
        return err;
    }

    uint32_t len = sizeof(ndef_msg_buf);
    err = create_item_id_ndef_msg(ndef_msg_buf, &len);
    if (err) {
        return err;
    }

    err = nfc_t2t_payload_set(ndef_msg_buf, len);
    if (err) {
        LOG_ERR("Failed to set NFC payload (err %d)", err);
        return err;
    }

    err = nfc_t2t_emulation_start();
    if (err) {
        LOG_ERR("Failed to start NFC emulation (err %d)", err);
        return err;
    }

    LOG_INF("✅ NFC tag ready — item ID: %s", current_item_id);
    return 0;
}

int nfc_update_item_id(const char *new_id, size_t id_len)
{
    if (id_len >= MAX_ITEM_ID_LEN) {
        LOG_ERR("Item ID too long");
        return -EINVAL;
    }

    memcpy(current_item_id, new_id, id_len);
    current_item_id[id_len] = '\0';
    current_item_id_len = id_len;

    uint32_t len = sizeof(ndef_msg_buf);
    int err = create_item_id_ndef_msg(ndef_msg_buf, &len);
    if (err) return err;

    err = nfc_t2t_payload_set(ndef_msg_buf, len);
    if (err) {
        LOG_ERR("Failed to set new payload (err %d)", err);
        return err;
    }

    LOG_INF("🔄 NFC tag updated — new item ID: %s", current_item_id);
    return 0;
}
```

## src/rental_logic.c
```c
#include <zephyr/kernel.h>
#include <zephyr/logging/log.h>
#include <string.h>
#include <stdio.h>
#include "rental_logic.h"
#include "ble_handler.h"  // assume you have ble_send(char )

LOG_MODULE_REGISTER(rental_logic, LOG_LEVEL_INF);

#define ITEM_ID_MAX_LEN 32
#define RENTAL_DURATION_MS 30000  // 30 seconds for demo

static int64_t rental_start_time = 0;
static bool rental_active = false;
static bool rental_expired_notified = false;
static char current_item_id[ITEM_ID_MAX_LEN] = {0};

void rental_logic_process_scan(const uint8_t *item_id, size_t item_id_len)
{
    if (item_id == NULL || item_id_len == 0 || item_id_len >= ITEM_ID_MAX_LEN) {
        LOG_ERR("Invalid item ID data");
        return;
    }

    strncpy(current_item_id, (const char *)item_id, item_id_len);
    current_item_id[item_id_len] = '\0';

    rental_start_time = k_uptime_get();
    rental_active = true;
    rental_expired_notified = false;

    LOG_INF("Rental started for item: %s", current_item_id);
}

void rental_logic_update_status(void)
{
    if (!rental_active && rental_expired_notified) {
        return;  // already notified, do nothing
    }

    int64_t now = k_uptime_get();
    int64_t elapsed = now - rental_start_time;

    if (elapsed >= RENTAL_DURATION_MS && rental_active) {
        rental_active = false;
        rental_expired_notified = true;

        char msg[64];
        snprintf(msg, sizeof(msg), "[%s] RENTAL EXPIRED", current_item_id);
        ble_send(msg);
        LOG_INF("%s", msg);

    } else if (rental_active) {
        char msg[64];
        snprintf(msg, sizeof(msg), "[%s] RENTAL ACTIVE", current_item_id);
        ble_send(msg);
        LOG_INF("%s", msg);
    }
}
```
